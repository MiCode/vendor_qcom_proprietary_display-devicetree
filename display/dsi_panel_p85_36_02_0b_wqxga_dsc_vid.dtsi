&mdss_mdp {
	dsi_panel_p85_36_02_0b_wqxga_dsc_vid: qcom,mdss_dsi_panel_p85_36_02_0b_wqxga_dsc_vid {
		qcom,mdss-dsi-panel-name =
			"p85 36 02 0b wqxga dsc vid panel";
		qcom,mdss-dsi-panel-type = "dsi_video_mode";

		qcom,dsi-ctrl-num = <0>;
		qcom,dsi-phy-num = <0>;

		qcom,mdss-dsi-virtual-channel-id = <0>;
		qcom,mdss-dsi-stream = <0>;
		qcom,mdss-dsi-h-left-border = <0>;
		qcom,mdss-dsi-h-right-border = <0>;
		qcom,mdss-dsi-v-top-border = <0>;
		qcom,mdss-dsi-v-bottom-border = <0>;
		qcom,mdss-dsi-bpp = <24>;
		qcom,mdss-dsi-color-order = "rgb_swap_rgb";
		qcom,mdss-dsi-underflow-color = <0xff>;
		qcom,mdss-dsi-border-color = <0>;
		qcom,mdss-dsi-h-sync-pulse = <0>;
		qcom,mdss-dsi-traffic-mode = "non_burst_sync_event";
		qcom,mdss-dsi-lane-map = "lane_map_0123";
		qcom,mdss-dsi-bllp-eof-power-mode;
		qcom,mdss-dsi-bllp-power-mode;
		qcom,mdss-dsi-tx-eot-append;
		qcom,mdss-dsi-lane-0-state;
		qcom,mdss-dsi-lane-1-state;
		qcom,mdss-dsi-lane-2-state;
		qcom,mdss-dsi-lane-3-state;
		qcom,mdss-dsi-dma-trigger = "trigger_sw";
		qcom,mdss-dsi-mdp-trigger = "none";
		qcom,mdss-dsi-lp11-init;
		qcom,platform-reset-gpio-always-on;
		qcom,mdss-dsi-bl-pmic-control-type = "bl_ctrl_external";
		qcom,mdss-dsi-reset-sequence = <0 5>, <1 5>, <0 5>, <1 15>;
		qcom,mdss-pan-physical-width-dimension = <1299>;
		qcom,mdss-pan-physical-height-dimension = <2078>;
		qcom,mdss-dsi-pan-enable-dynamic-fps;
		qcom,mdss-dsi-pan-fps-update = "dfps_immediate_porch_mode_vfp";
		qcom,dsi-supported-dfps-list = <120 90 60>;
		qcom,mdss-dsi-display-timings {
			timing@0 {
				qcom,mdss-dsi-video-mode;
				qcom,mdss-dsi-panel-width = <1280>;
				qcom,mdss-dsi-panel-height = <2048>;
				qcom,mdss-dsi-h-pulse-width = <16>;
				qcom,mdss-dsi-h-back-porch = <52>;
				qcom,mdss-dsi-h-front-porch = <56>;

				qcom,mdss-dsi-h-sync-skew = <0>;
				qcom,mdss-dsi-v-pulse-width = <2>;
				qcom,mdss-dsi-v-back-porch = <18>;
				qcom,mdss-dsi-v-front-porch = <358>;
				qcom,mdss-dsi-panel-framerate = <120>;
				qcom,mdss-dsi-panel-clockrate = <964000000>;
				qcom,mdss-dsi-on-command = [
					39 01 00 00 00 00 02 FF F0
					39 01 00 00 00 00 02 FB 01
					39 01 00 00 00 00 02 24 02

					39 01 00 00 00 00 02 FF 20
					39 01 00 00 00 00 02 FB 01
					39 01 00 00 00 00 02 01 44
					39 01 00 00 00 00 02 02 44
					39 01 00 00 00 00 02 7C 00

					39 01 00 00 00 00 02 FF 24
					39 01 00 00 00 00 02 FB 01
					39 01 00 00 00 00 02 5A 09
					39 01 00 00 00 00 02 5B 6A
					39 01 00 00 00 00 02 5C DF
					39 01 00 00 00 00 02 5D 00
					39 01 00 00 00 00 02 DB 3B

					39 01 00 00 00 00 02 FF 26
					39 01 00 00 00 00 02 FB 01
					39 01 00 00 00 00 04 3D 00 00 00

					39 01 00 00 00 00 02 FF 27
					39 01 00 00 00 00 02 FB 01
					39 01 00 00 00 00 02 D0 31
					39 01 00 00 00 00 02 D1 25
					39 01 00 00 00 00 02 DE 43
					39 01 00 00 00 00 02 DF 02
					39 01 00 00 00 00 02 5F 10
					39 01 00 00 00 00 02 60 00
					39 01 00 00 00 00 02 77 20

					39 01 00 00 00 00 02 FF 2A
					39 01 00 00 00 00 02 FB 01
					39 01 00 00 00 00 02 64 12
					39 01 00 00 00 00 02 65 00
					39 01 00 00 00 00 02 67 16
					39 01 00 00 00 00 02 6A 16
					39 01 00 00 00 00 02 70 1E
					39 01 00 00 00 00 02 7F 12
					39 01 00 00 00 00 02 82 16
					39 01 00 00 00 00 02 BC 77

					39 01 00 00 00 00 02 FF F0
					39 01 00 00 00 00 02 FB 01
					39 01 00 00 00 00 02 24 02

					39 01 00 00 00 00 02 FF 2A
					39 01 00 00 00 00 02 FB 01
					39 01 00 00 00 00 02 BC 77

					39 01 00 00 00 00 02 FF 23
					39 01 00 00 00 00 02 FB 01
					39 01 00 00 00 00 02 00 80
					39 01 00 00 00 00 02 01 84
					39 01 00 00 00 00 02 07 00
					39 01 00 00 00 00 02 08 01
					39 01 00 00 00 00 02 09 C2
					39 01 00 00 00 00 02 10 7F
					39 01 00 00 00 00 02 11 01
					39 01 00 00 00 00 02 12 99
					39 01 00 00 00 00 02 15 CD
					39 01 00 00 00 00 02 16 15
					39 01 00 00 00 00 02 29 0A
					39 01 00 00 00 00 02 2A 13
					39 01 00 00 00 00 02 2B 0E
					39 01 00 00 00 00 02 30 FF
					39 01 00 00 00 00 02 31 FE
					39 01 00 00 00 00 02 32 FD
					39 01 00 00 00 00 02 33 FC
					39 01 00 00 00 00 02 34 FC
					39 01 00 00 00 00 02 35 FB
					39 01 00 00 00 00 02 36 FA
					39 01 00 00 00 00 02 37 F9
					39 01 00 00 00 00 02 38 F9
					39 01 00 00 00 00 02 39 F9
					39 01 00 00 00 00 02 3A F9
					39 01 00 00 00 00 02 3B F7
					39 01 00 00 00 00 02 3D F5
					39 01 00 00 00 00 02 3F F2
					39 01 00 00 00 00 02 40 F2
					39 01 00 00 00 00 02 41 F2
					39 01 00 00 00 00 02 45 FF
					39 01 00 00 00 00 02 46 FA
					39 01 00 00 00 00 02 47 F3
					39 01 00 00 00 00 02 48 EF
					39 01 00 00 00 00 02 49 EF
					39 01 00 00 00 00 02 4A E9
					39 01 00 00 00 00 02 4B E6
					39 01 00 00 00 00 02 4C DF
					39 01 00 00 00 00 02 4D D9
					39 01 00 00 00 00 02 4E D6
					39 01 00 00 00 00 02 4F C9
					39 01 00 00 00 00 02 50 C5
					39 01 00 00 00 00 02 51 BE
					39 01 00 00 00 00 02 52 B7
					39 01 00 00 00 00 02 53 B5
					39 01 00 00 00 00 02 54 B3
					39 01 00 00 00 00 02 58 FF
					39 01 00 00 00 00 02 59 FB
					39 01 00 00 00 00 02 5A F7
					39 01 00 00 00 00 02 5B F3
					39 01 00 00 00 00 02 5C EF
					39 01 00 00 00 00 02 5D E3
					39 01 00 00 00 00 02 5E D8
					39 01 00 00 00 00 02 5F D6
					39 01 00 00 00 00 02 60 D6
					39 01 00 00 00 00 02 61 D3
					39 01 00 00 00 00 02 62 CF
					39 01 00 00 00 00 02 63 CE
					39 01 00 00 00 00 02 64 C9
					39 01 00 00 00 00 02 65 C5
					39 01 00 00 00 00 02 66 C3
					39 01 00 00 00 00 02 67 BE

					39 01 00 00 00 00 02 FF 10
					39 01 00 00 00 00 02 FB 01
					39 01 00 00 00 00 07 3B 03 14 FF 04 04 00
					39 01 00 00 00 00 02 90 03
					39 01 00 00 00 00 11 91 89 A8 00 10 D2 00 02 5C 01 93 00 08 06 EF 05 4F
					39 01 00 00 00 00 03 92 10 E0
					39 01 00 00 00 00 02 BB 03
					39 01 00 00 00 00 03 51 00 00
					39 01 00 00 00 00 02 53 24
                                        39 01 00 00 00 00 02 55 00
					05 01 00 00 69 00 01 11
					05 01 00 00 00 00 01 29
				];
				qcom,mdss-dsi-off-command = [
					15 01 00 00 0A 00 02 28 00
					15 01 00 00 64 00 02 10 00
				];
				qcom,mdss-dsi-gesture-commands = [
					15 01 00 00 0A 00 02 28 00
					15 01 00 00 64 00 02 10 00
				];
				mi,mdss-dsi-backlight-pwm-command = [
					39 01 00 00 05 00 03 51 0f ff
					39 01 00 00 00 00 02 53 2c
				];
				mi,mdss-dsi-cabc-ui-on-command = [
					39 01 00 00 00 00 02 55 01
				];
				mi,mdss-dsi-cabc-still-on-command =[
					39 01 00 00 00 00 02 55 02
				];
				mi,mdss-dsi-cabc-movie-on-command = [
					39 01 00 00 00 00 02 55 03
				];
				mi,mdss-dsi-cabc-off-command =[
					39 01 00 00 00 00 02 55 00
				];
				qcom,mdss-dsi-on-command-state = "dsi_lp_mode";
				qcom,mdss-dsi-off-command-state = "dsi_lp_mode";
				qcom,mdss-dsi-gesture-commands-state = "dsi_lp_mode";
				mi,mdss-dsi-backlight-pwm-command-state = "dsi_lp_mode";
				mi,mdss-dsi-cabc-ui-on-command-state = "dsi_lp_mode";
				mi,mdss-dsi-cabc-still-on-command-state = "dsi_lp_mode";
				mi,mdss-dsi-cabc-movie-on-command-state = "dsi_lp_mode";
				mi,mdss-dsi-cabc-off-command-state = "dsi_lp_mode";
				qcom,compression-mode = "dsc";
				qcom,mdss-dsc-version = <0x11>;
				qcom,mdss-dsc-scr-version = <0x0>;
				qcom,mdss-dsc-slice-height = <16>;
				qcom,mdss-dsc-slice-width = <640>;
				qcom,mdss-dsc-slice-per-pkt = <2>;
				qcom,mdss-dsc-bit-per-component = <8>;
				qcom,mdss-dsc-bit-per-pixel = <8>;
				qcom,mdss-dsc-block-prediction-enable;
			};
		};
	};
};

&mdss_mdp {
	dsi_p16u_41_02_0c_dsc_vid: qcom,mdss_dsi_p16u_41_02_0c_dsc_vid {
		qcom,mdss-dsi-panel-name = "p16u 41 02 0c video mode dsc dsi panel";
		qcom,mdss-dsi-panel-type = "dsi_video_mode";
		qcom,mdss-dsi-virtual-channel-id = <0>;
		qcom,mdss-dsi-stream = <0>;
		qcom,mdss-dsi-bpp = <30>;
		qcom,mdss-dsi-color-order = "rgb_swap_rgb";
		qcom,mdss-dsi-underflow-color = <0xff>;
		qcom,mdss-dsi-border-color = <0>;
		qcom,dsi-ctrl-num = <0>;
		qcom,dsi-phy-num = <0>;
		qcom,mdss-dsi-traffic-mode = "burst_mode";
		qcom,mdss-dsi-lane-map = "lane_map_0123";
		qcom,mdss-dsi-bllp-eof-power-mode;
		qcom,mdss-dsi-bllp-power-mode;
		qcom,mdss-dsi-lane-0-state;
		qcom,mdss-dsi-lane-1-state;
		qcom,mdss-dsi-lane-2-state;
		qcom,mdss-dsi-lane-3-state;
		qcom,mdss-dsi-dma-trigger = "trigger_sw";
		qcom,mdss-dsi-mdp-trigger = "none";
		qcom,mdss-dsi-reset-sequence =<0 11>, <1 6>, <0 5>, <1 11>;
		qcom,mdss-pan-physical-width-dimension = <727>;
		qcom,mdss-pan-physical-height-dimension = <1575>;

		qcom,mdss-dsi-tx-eot-append;
		qcom,mdss-dsi-lp11-init;
		qcom,mdss-dsi-bl-inverted-dbv;
		qcom,bl-update-flag = "delay_until_first_frame";
		qcom,mdss-dsi-panel-hdr-enabled;
		qcom,mdss-dsi-panel-hdr-color-primaries = <14500 15500 32000 17000 15500 30000 8000 3000>;
		qcom,mdss-dsi-panel-peak-brightness = <32000000>;
		qcom,mdss-dsi-panel-blackness-level = <3230>;
		qcom,mdss-dsi-dma-schedule-line = <1>;
		qcom,mdss-disable-cesta-hw-sleep;

		mi,mdss-dsi-panel-wp-read-command = [06 01 00 01 00 00 01 AC];
		mi,mdss-dsi-panel-wp-read-command-state = "dsi_lp_mode";
		mi,mdss-dsi-panel-wp-read-pre-tx-command = [39 00 00 00 00 00 02 6F 25];
		mi,mdss-dsi-panel-wp-read-pre-tx-command-state = "dsi_hs_mode";
		mi,mdss-dsi-panel-wp-read-length = <3>;

		/*flat mode*/
		mi,flatmode-default-on-enabled;
		mi,flatmode-status-check-enabled;
		mi,mdss-dsi-panel-flatmode-status-command = [
			06 01 00 01 00 00 01 5F
		];
		mi,mdss-dsi-panel-flatmode-status-command-state = "dsi_lp_mode";
		mi,mdss-dsi-panel-flatmode-status-read-length = <1>;
		mi,mdss-dsi-panel-flatmode-on-status-value = <0x00>;

		qcom,mdss-dsi-pan-enable-dynamic-fps;
		qcom,mdss-dsi-pan-fps-update =
			"dfps_immediate_porch_mode_vfp";
		qcom,dsi-supported-dfps-list = <120 90 60 30>;

		qcom,mdss-dsi-display-timings {
			timing@0 {
				qcom,mdss-dsi-video-mode;
				qcom,mdss-dsi-panel-framerate = <120>;
				#include "dsi-panel-p16u-41-02-0c-dsc-video-common.dtsi"
				qcom,mdss-dsi-on-command = [
					//Adjust the pluse width
					39 00 00 40 00 00 06 F0 55 AA 52 08 00
					39 00 00 40 00 00 02 6F 02
					39 00 00 40 00 00 03 B5 16 C5
					//solve AOD off flash
					39 00 00 40 00 00 06 F0 55 AA 52 08 03
					39 00 00 40 00 00 06 BB 31 10 00 3D 09
					39 00 00 40 00 00 02 6F 05
					39 00 00 40 00 00 04 BB 00 3D 09
					39 00 00 40 00 00 02 6F 08
					39 00 00 40 00 00 04 BB 00 3D 09
					39 00 00 40 00 00 02 6F 0E
					39 00 00 40 00 00 04 BB 00 3E 0B
					39 00 00 40 00 00 02 6F 11
					39 00 00 00 00 00 0A BB 00 00 6A 6A 00 00 6A 6A 6A
					//ACL ON1800NIT
					39 00 00 40 00 00 06 F0 55 AA 52 08 00
					39 00 00 40 00 00 02 B0 04
					39 00 00 40 00 00 02 6F 01
					39 00 00 40 00 00 11 B0 00 06 00 18 00 40 00 70 00 C6 01 76 01 C7 01 FF
					39 00 00 40 00 00 02 6F 11
					39 00 00 40 00 00 07 B0 00 AA 00 AC 00 AA
					39 00 00 40 00 00 02 6F 59
					39 00 00 40 00 00 07 B0 02 80 05 00 02 80
					39 00 00 40 00 00 02 6F 17
					39 00 00 40 00 00 0B B0 00 00 00 00 2D 26 33 90 3F FF
					39 00 00 40 00 00 02 6F 21
					39 00 00 40 00 00 0D B0 00 00 00 00 00 00 00 00 00 9F 00 9F
					39 00 00 40 00 00 02 6F 2D
					39 00 00 40 00 00 0D B0 00 00 00 00 00 00 00 00 00 00 00 9F
					39 00 00 40 00 00 02 6F 45
					39 00 00 40 00 00 07 B0 00 00 00 00 1F 4B
					39 00 00 40 00 00 02 6F 4B
					39 00 00 00 00 00 07 B0 00 00 00 00 00 31
					//esd
					39 00 00 40 00 00 06 F0 55 AA 52 08 00
					39 00 00 40 00 00 05 BE 45 4A 49 47
					39 00 00 40 00 00 02 6F 05
					39 00 00 40 00 00 02 BE 08
					//lvdt On
					39 00 00 40 00 00 06 F0 55 AA 52 08 01
					39 00 00 40 00 00 02 6F 03
					39 00 00 40 00 00 02 C7 47
					//video trim
					39 00 00 40 00 00 06 F0 55 AA 52 08 01
					39 00 00 40 00 00 02 EA 91
					39 00 00 40 00 00 02 6F 07
					39 00 00 40 00 00 05 EA 01 3F 01 3F
					39 00 00 40 00 00 02 6F 11
					39 00 00 40 00 00 02 EA 91
					39 00 00 40 00 00 02 6F 18
					39 00 00 40 00 00 05 EA 01 68 01 68
					39 00 00 40 00 00 02 6F 04
					39 00 00 40 00 00 02 C3 0A
					39 00 00 40 00 00 02 6F 09
					39 00 00 00 00 00 02 C3 0A
					39 00 00 00 00 00 02 5F 00
					//common code
					39 00 00 40 00 00 06 F0 55 AA 52 08 01
					39 00 00 40 00 00 02 6F 01
					39 00 00 40 00 00 02 C9 61
					39 00 00 40 00 00 06 F0 55 AA 52 08 04
					39 00 00 40 00 00 02 6F 02
					39 00 00 40 00 00 03 C7 00 42
					39 00 00 40 00 00 02 6F 08
					39 00 00 00 05 00 02 C7 04
					39 00 00 40 00 00 06 F0 55 AA 52 08 04
					39 00 00 40 00 00 02 6F 01
					39 00 00 40 00 00 02 C7 11
					39 00 00 40 00 00 02 6F 02
					39 00 00 00 00 00 07 C7 00 42 00 42 00 42
					//dpc_opt
					39 00 00 40 00 00 02 6F 09
					39 00 00 40 00 00 03 C7 00 42
					39 00 00 40 00 00 05 FF AA 55 A5 84
					39 00 00 40 00 00 02 6F 10
					39 00 00 40 00 00 02 F8 02
					39 00 00 40 00 00 02 6F A9
					39 00 00 00 00 00 02 F4 F3
					//GMA conv off
					39 00 00 40 00 00 02 6F 27
					39 00 00 40 00 00 02 F7 00
					39 00 00 40 00 00 02 F2 15
					39 00 00 40 00 00 05 FF AA 55 A5 80
					39 00 00 40 00 00 02 6F 08
					39 00 00 40 00 00 02 F6 40
					39 00 00 40 00 00 02 6F 0A
					39 00 00 40 00 00 02 F6 77
					39 00 00 40 00 00 02 6F 0B
					39 00 00 40 00 00 02 F6 77
					39 00 00 40 00 00 02 6F 0E
					39 00 00 40 00 00 02 F6 77
					39 00 00 40 00 00 02 6F 0C
					39 00 00 40 00 00 02 F6 77
					39 00 00 40 00 00 02 6F 0D
					39 00 00 40 00 00 02 F6 77
					39 00 00 40 00 00 02 6F 0F
					39 00 00 00 00 00 02 F6 77
					//SRLAT_DLY_OUT2_SD
					39 00 00 40 00 00 02 6F 04
					39 00 00 40 00 00 02 F7 04
					39 00 00 40 00 00 02 6F 1B
					39 00 00 40 00 00 02 F4 04
					39 00 00 40 00 00 02 17 03
					39 00 00 00 00 00 02 26 00
					//FPS 120
					39 00 00 00 00 00 02 2F 00
					39 00 00 40 00 00 02 35 00
					39 00 00 40 00 00 05 3B 00 14 00 38
					39 00 00 40 00 00 02 6F 04
					39 00 00 40 00 00 05 3B 00 14 03 DC
					39 00 00 40 00 00 02 6F 08
					39 00 00 40 00 00 05 3B 00 14 0B 58
					39 00 00 40 00 00 02 6F 10
					39 00 00 00 00 00 05 3B 00 14 00 38
					//backlight
					39 00 00 40 00 00 03 51 00 00
					39 00 00 40 00 00 02 6F 04
					39 00 00 40 00 00 03 51 00 00
					39 00 00 40 00 00 02 53 20
					39 00 00 40 00 00 02 55 05
					39 00 00 40 00 00 02 62 80
					39 00 00 40 00 00 02 71 00
					39 00 00 00 00 00 03 81 01 19
					//ffr
					39 00 00 40 00 00 06 88 01 02 80 09 D7
					39 00 00 40 00 00 09 8D 00 00 04 FF 00 00 0A D3
					39 00 00 40 00 00 02 03 01
					39 00 00 40 00 00 03 90 03 43
					39 00 00 40 00 00 13 91 AB A8 00 0C C2 00 02 41 01 38 00 08 08 BB 07 21 10 F0
					39 00 00 40 00 00 06 F0 55 AA 52 08 05
					39 00 00 00 00 00 06 CB 33 33 33 33 33
					/* Display On */
					05 00 00 00 78 00 01 11
					05 00 00 00 00 00 01 29
					39 00 00 40 00 00 06 F0 55 AA 52 08 09
					39 00 00 40 00 00 02 B0 01
					39 00 00 40 00 00 02 6F 25
					39 00 00 00 00 00 02 B0 05
				];
				qcom,mdss-dsi-on-command-state = "dsi_lp_mode";
				/* FPS Switch Setting */
				mi,mdss-dsi-fps-120-gamma-command = [
					39 00 00 00 00 00 02 2F 00
				];
				mi,mdss-dsi-fps-120-gamma-command-state = "dsi_hs_mode";
				mi,mdss-dsi-fps-90-gamma-command = [
					39 00 00 00 00 00 02 2F 01
				];
				mi,mdss-dsi-fps-90-gamma-command-state = "dsi_hs_mode";
				mi,mdss-dsi-fps-60-gamma-command = [
					39 00 00 00 00 00 02 2F 02
				];
				mi,mdss-dsi-fps-60-gamma-command-state = "dsi_hs_mode";
				//AOD
				qcom,mdss-dsi-nolp-command = [
					39 00 00 40 00 00 02 6F 04
					39 00 00 40 00 00 03 51 00 00
					05 00 00 00 00 00 01 38
				];
				qcom,mdss-dsi-nolp-command-update = <0x51 1 2>;
				qcom,mdss-dsi-nolp-command-state = "dsi_hs_mode";
				mi,mdss-dsi-aod-enter-command = [
					05 00 00 00 00 00 01 39
				];
				mi,mdss-dsi-aod-enter-command-state = "dsi_hs_mode";

				mi,mdss-dsi-doze-hbm-command = [
					39 00 00 40 00 00 03 51 03 6A
					15 00 00 40 00 00 02 6F 04
					39 00 00 00 00 00 03 51 3F F8
				];
				mi,mdss-dsi-doze-hbm-command-state = "dsi_hs_mode";

				mi,mdss-dsi-doze-lbm-command = [
					39 00 00 40 00 00 03 51 00 3B
					39 00 00 40 00 00 02 6F 04
					39 00 00 00 00 00 03 51 05 55
				];
				mi,mdss-dsi-doze-lbm-command-state = "dsi_hs_mode";

				mi,mdss-dsi-aod-exit-command = [
					05 00 00 00 00 00 01 38
				];
				mi,mdss-dsi-aod-exit-command-state = "dsi_hs_mode";

				mi,mdss-dsi-doze-hbm-nolp-command = [
					39 00 00 00 00 00 03 51 03 6A
				];
				mi,mdss-dsi-doze-hbm-nolp-command-state = "dsi_hs_mode";

				mi,mdss-dsi-doze-lbm-nolp-command = [
					39 00 00 00 00 00 03 51 00 3B
				];
				mi,mdss-dsi-doze-lbm-nolp-command-state = "dsi_hs_mode";

				//lhbm code
				mi,mdss-dsi-local-hbm-normal-white-1000nit-command = [
					/*1200nit default D1*/
					39 00 00 40 00 00 06 F0 55 AA 52 08 02
					39 00 00 40 00 00 07 D1 26 C4 24 10 2C 4A
					/*FPR ON*/
					39 00 00 00 00 00 0D A9 01 00 8B 01 01 01 01 00 87 00 00 25
				];
				mi,mdss-dsi-local-hbm-normal-white-1000nit-command-update = <0xD1 1 6>;
				mi,mdss-dsi-local-hbm-normal-white-1000nit-command-state = "dsi_hs_mode";
				mi,mdss-dsi-local-hbm-hlpm-white-1000nit-command = [
					/*1200nit default D1*/
					39 00 00 40 00 00 06 F0 55 AA 52 08 02
					39 00 00 40 00 00 07 D1 26 C4 24 10 2C 4A
					/*FPR ON*/
					39 00 00 00 00 00 13 A9 01 00 38 00 00 00 01 00 8B 01 01 01 01 00 87 00 00 25
				];
				mi,mdss-dsi-local-hbm-hlpm-white-1000nit-command-update = <0xD1 1 6>;
				mi,mdss-dsi-local-hbm-hlpm-white-1000nit-command-state = "dsi_hs_mode";
				mi,mdss-dsi-local-hbm-normal-white-110nit-command = [
					/*200nit default D1*/
					39 00 00 40 00 00 06 F0 55 AA 52 08 02
					39 00 00 40 00 00 07 D1 26 C4 24 10 2C 4A
					/*FPR ON*/
					39 00 00 00 00 00 0D A9 01 00 8B 01 01 01 01 00 87 00 00 25
				];
				mi,mdss-dsi-local-hbm-normal-white-110nit-command-update = <0xD1 1 6>;
				mi,mdss-dsi-local-hbm-normal-white-110nit-command-state = "dsi_hs_mode";
				mi,mdss-dsi-local-hbm-hlpm-white-110nit-command = [
					/*200nit default D1*/
					39 00 00 40 00 00 06 F0 55 AA 52 08 02
					39 00 00 40 00 00 07 D1 26 C4 24 10 2C 4A
					/*FPR ON*/
					39 00 00 00 00 00 13 A9 01 00 38 00 00 00 01 00 8B 01 01 01 01 00 87 00 00 25
				];
				mi,mdss-dsi-local-hbm-hlpm-white-110nit-command-update = <0xD1 1 6>;
				mi,mdss-dsi-local-hbm-hlpm-white-110nit-command-state = "dsi_hs_mode";
				mi,mdss-dsi-local-hbm-off-to-normal-command = [
					/*FPR OFF*/
					39 00 00 00 00 00 0D A9 01 00 8B 01 01 00 01 00 87 00 00 00
				];
				mi,mdss-dsi-local-hbm-off-to-normal-command-state = "dsi_hs_mode";
				mi,mdss-dsi-local-hbm-off-to-hbm-command = [
					/*FPR OFF*/
					39 00 00 00 00 00 0D A9 01 00 8B 01 01 00 01 00 87 00 00 00
				];
				mi,mdss-dsi-local-hbm-off-to-hbm-command-state = "dsi_hs_mode";
			};
		};
	};
};

&dsi_p16u_41_02_0c_dsc_vid {
	qcom,panel-supply-entries = <&dsi_panel_pwr_supply_p16u>;
	qcom,mdss-dsi-bl-pmic-control-type = "bl_ctrl_dcs";
	qcom,mdss-dsi-bl-min-level = <15>;
	qcom,mdss-dsi-bl-max-level = <16383>;
	qcom,mdss-brightness-max-level = <16383>;
	qcom,mdss-brightness-init-level = <1228>;
	qcom,mdss-dsi-bl-inverted-dbv;
	qcom,platform-reset-gpio = <&tlmm 12 0>;
	mi,disable-ic-dimming-flag;

	qcom,ulps-enabled;
	qcom,dsi-select-clocks = "pll_byte_clk0", "pll_dsi_clk0";
	qcom,mdss-dsi-clk-strength = <0xFF>;

	mi,panel-id = <0x50313655 0x0041020C>;
	mi,panel-on-dimming-delay = <120>;
	mi,max-brightness-clone = <16383>;
	mi,mdss-dsi-fac-bl-max-level = <10926>;
	mi,mdss-fac-brightness-max-level = <10926>;
	mi,thermal-dimming-flag;
	/* IRQF_ONESHOT | IRQF_TRIGGER_HEIGH */
	mi,esd-err-irq-gpio = <&tlmm 149 0x2004>;
	mi,panel-ignore-esd-in-aod;

	mi,is-tddi-flag;//for double click
	/* AOD CONFIG*/
	mi,doze-hbm-dbv-level = <874>;
	mi,doze-lbm-dbv-level = <59>;

	mi,ddic-round-corner-enabled;

	//lhbm
	mi,local-hbm-enabled;
	mi,need-fod-animal-in-normal-enabled;
	mi,local-hbm-ui-ready-delay-num-frame = <3>; /* 3 frame */
	mi,local-hbm-update-with-hbm-mode-threshold = <16383>;
};
/dts-v1/;
/plugin/;

#include "kunzite-sde-display-qrd.dtsi"

/{
	model = "Qualcomm Technologies, Inc. Kunzite QRD";
	compatible = "qcom,parrot-qrd", "qcom,parrot", "qcom,qrd";
	qcom,msm-id = <537 0x10000>, <583 0x10000>, <613 0x10000>, <631 0x10000>, <633 0x10000>, <634 0x10000>, <638 0x10000>, <663 0x10000>;
	qcom,board-id = <0x2000B 0>, <0x2000B 1>, <0x2000B 0x600>, <0x2000B 0x601>, <0x2000B 2>;
};

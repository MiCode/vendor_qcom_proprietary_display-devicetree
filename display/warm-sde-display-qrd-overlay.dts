/dts-v1/;
/plugin/;

#include "warm-sde-display-qrd.dtsi"

/ {
	model = "Qualcomm Technologies, Inc. Warm QRD";
	compatible = "qcom,pitti-qrd", "qcom,pitti", "qcom,qrd";
	qcom,msm-id = <623 0x10000>;
	qcom,board-id = <0x2000B 0>, <0x2000B 0x600>;
	qcom,pmic-id-size = <9>;
	qcom,pmic-id = <0x0 0x0 0x2E 0x0 0x0 0x0 0x0 0x0 0x0>;
};


&mdss_mdp {
	dsi_p16u_42_02_0a_dsc_vid: qcom,mdss_dsi_p16u_42_02_0a_dsc_vid {
		qcom,mdss-dsi-panel-name = "xiaomi p16u 42 02 0a video mode dsc dsi panel";
		qcom,mdss-dsi-panel-type = "dsi_video_mode";
		qcom,mdss-dsi-virtual-channel-id = <0>;
		qcom,mdss-dsi-stream = <0>;
		qcom,mdss-dsi-bpp = <30>;
		qcom,mdss-dsi-color-order = "rgb_swap_rgb";
		qcom,mdss-dsi-underflow-color = <0xff>;
		qcom,mdss-dsi-border-color = <0>;
		qcom,dsi-ctrl-num = <0>;
		qcom,dsi-phy-num = <0>;
		qcom,mdss-dsi-traffic-mode = "burst_mode";
		qcom,mdss-dsi-lane-map = "lane_map_0123";
		qcom,mdss-dsi-bllp-eof-power-mode;
		qcom,mdss-dsi-bllp-power-mode;
		qcom,mdss-dsi-lane-0-state;
		qcom,mdss-dsi-lane-1-state;
		qcom,mdss-dsi-lane-2-state;
		qcom,mdss-dsi-lane-3-state;
		qcom,mdss-dsi-dma-trigger = "trigger_sw";
		qcom,mdss-dsi-mdp-trigger = "none";
		qcom,mdss-dsi-reset-sequence = <0 11>, <1 6>, <0 5>, <1 11>;
		qcom,mdss-pan-physical-width-dimension = <727>;
		qcom,mdss-pan-physical-height-dimension = <1575>;
		qcom,mdss-dsi-tx-eot-append;
		qcom,mdss-dsi-lp11-init;
		qcom,mdss-dsi-bl-inverted-dbv;
		qcom,bl-update-flag = "delay_until_first_frame";
		qcom,mdss-dsi-panel-hdr-enabled;
		qcom,mdss-dsi-panel-hdr-color-primaries = <14500 15500 32000 17000 15500 30000 8000 3000>;
		qcom,mdss-dsi-panel-peak-brightness = <32000000>;
		qcom,mdss-dsi-panel-blackness-level = <3230>;
		qcom,mdss-dsi-dma-schedule-line = <1>;
		qcom,mdss-disable-cesta-hw-sleep;

		mi,mdss-dsi-panel-wp-read-command = [06 01 00 01 00 00 01 A3];
		mi,mdss-dsi-panel-wp-read-command-state = "dsi_lp_mode";
		mi,mdss-dsi-panel-wp-read-pre-tx-command = [39 00 00 00 00 00 02 6F 7A];
		mi,mdss-dsi-panel-wp-read-pre-tx-command-state = "dsi_hs_mode";
		mi,mdss-dsi-panel-wp-read-length = <8>;

		mi,mdss-dsi-panel-cell-id-read-command = [06 01 00 01 00 00 01 AC];
		mi,mdss-dsi-panel-cell-id-read-command-state = "dsi_lp_mode";
		mi,mdss-dsi-panel-cell-id-read-length = <13>;

		/*flat mode*/
		mi,flatmode-default-on-enabled;
		mi,flatmode-status-check-enabled;
		mi,mdss-dsi-panel-flatmode-status-command = [
			06 01 00 01 00 00 01 5F
		];
		mi,mdss-dsi-panel-flatmode-status-command-state = "dsi_lp_mode";
		mi,mdss-dsi-panel-flatmode-status-read-length = <1>;
		mi,mdss-dsi-panel-flatmode-on-status-value = <0x00>;

		qcom,mdss-dsi-pan-enable-dynamic-fps;
		qcom,mdss-dsi-pan-fps-update =
		 	"dfps_immediate_porch_mode_vfp";
		qcom,dsi-supported-dfps-list = <120 90 60 30>;
		qcom,mdss-dsi-display-timings {
			timing@0{
				qcom,mdss-dsi-video-mode;
				qcom,mdss-dsi-panel-framerate = <120>;
				#include "dsi-panel-p16u-42-02-0a-dsc-video-common.dtsi"
				qcom,mdss-dsi-on-command = [
					//video trim
					39 00 00 40 00 00 06 F0 55 AA 52 08 01
					39 00 00 40 00 00 02 EA 91
					39 00 00 40 00 00 02 6F 07
					39 00 00 40 00 00 05 EA 01 3F 01 3F
					39 00 00 40 00 00 02 6F 11
					39 00 00 40 00 00 02 EA 91
					39 00 00 40 00 00 02 6F 18
					39 00 00 40 00 00 05 EA 01 68 01 68
					39 00 00 40 00 00 02 6F 04
					39 00 00 40 00 00 02 C3 0A
					39 00 00 40 00 00 02 6F 09
					39 00 00 00 00 00 02 C3 0A
					//OD on
					39 00 00 40 00 00 06 F0 55 AA 52 08 08
					39 00 00 40 00 00 02 E0 41
					//LVDT on
					39 00 00 40 00 00 06 F0 55 AA 52 08 01
					39 00 00 40 00 00 02 6F 03
					39 00 00 40 00 00 02 C7 C7
					//OSC
					39 00 00 40 00 00 05 FF AA 55 A5 80
					39 00 00 40 00 00 02 6F 47
					39 00 00 40 00 00 02 F2 21
					39 00 00 40 00 00 06 F0 55 AA 52 08 01
					39 00 00 40 00 00 02 6F 01
					39 00 00 40 00 00 02 C5 02
					//Lhbm gamma mode
					39 00 00 40 00 00 06 F0 55 AA 52 08 00
					39 00 00 40 00 00 03 DF 21 54
					39 00 00 40 00 00 02 6F 63
					39 00 00 40 00 00 05 B2 00 00 04 37
					//esd
					39 00 00 40 00 00 02 6F 05
					39 00 00 40 00 00 02 BE 08
					//P1
					39 00 00 40 00 00 06 F0 55 AA 52 08 09
					39 00 00 40 00 00 02 6F 00
					39 00 00 40 00 00 02 B0 01
					39 00 00 40 00 00 02 6F 25
					39 00 00 00 00 00 02 B0 00
					//sop bais
					39 00 00 40 00 00 05 FF AA 55 A5 80
					39 00 00 40 00 00 02 6F 1B
					39 00 00 40 00 00 02 F4 04
					//vdc fpr
					39 00 00 40 00 00 06 88 01 02 80 09 D6
					39 00 00 40 00 00 06 F0 55 AA 52 08 08
					39 00 00 40 00 00 02 6F 5F
					39 00 00 00 00 00 02 B8 01
					//VBP VFP setting
					39 00 00 40 00 00 05 3B 00 14 00 38
					39 00 00 40 00 00 02 6F 04
					39 00 00 40 00 00 05 3B 00 14 03 DC
					39 00 00 40 00 00 02 6F 08
					39 00 00 40 00 00 05 3B 00 14 0B 58
					39 00 00 40 00 00 02 6F 10
					39 00 00 00 00 00 05 3B 00 14 00 38
					//vdo & AOD_1ST & VESA setting
					39 00 00 40 00 00 02 71 00
					39 00 00 40 00 00 09 8D 00 00 04 FF 00 00 0A D3
					39 00 00 40 00 00 03 90 03 43
					39 00 00 00 00 00 13 91 AB A8 00 0C C2 00 02 41 01 38 00 08 08 BB 07 21 10 F0
					//power off timing
					39 00 00 40 00 00 05 FF AA 55 A5 80
					39 00 00 40 00 00 02 6F 0A
					39 00 00 40 00 00 06 F6 60 60 60 60 60
					39 00 00 40 00 00 05 FF AA 55 A5 80
					39 00 00 40 00 00 02 6F 04
					39 00 00 40 00 00 02 F7 04
					39 00 00 40 00 00 02 6F 09
					39 00 00 00 00 00 02 FC 10
					//DC_DPC_ON & ACTC & LCTC
					39 00 00 40 00 00 02 8B 00
					39 00 00 40 00 00 05 FF AA 55 A5 84
					39 00 00 40 00 00 02 6F 10
					39 00 00 40 00 00 02 F8 02
					39 00 00 40 00 00 02 6F A9
					39 00 00 00 00 00 02 F4 F3
					//TE_ON & ACE_EN & FPS 120
					39 00 00 40 00 00 02 35 00
					39 00 00 40 00 00 02 55 04
					39 00 00 40 00 00 05 FF AA 55 A5 81
					39 00 00 40 00 00 02 6F 0B
					39 00 00 40 00 00 02 FD 40
					39 00 00 40 00 00 06 A3 81 84 38 2A AE
					/*new code*/
					39 00 00 40 00 00 06 F0 55 AA 52 08 01
					39 00 00 40 00 00 02 6F 09
					39 00 00 40 00 00 02 D2 00
					39 00 00 40 00 00 06 F0 55 AA 52 08 05
					39 00 00 40 00 00 06 CB 33 33 33 33 33
					//slove off flash
					39 00 00 40 00 00 06 F0 55 AA 52 08 03
					39 00 00 40 00 00 03 BC 22 10
					39 00 00 40 00 00 02 6F 02
					39 00 00 40 00 00 0D BC 00 23 3D 00 23 3C 00 23 3D 00 23 3D
					39 00 00 40 00 00 02 6F 0E
					39 00 00 40 00 00 04 BC 00 23 3D
					39 00 00 40 00 00 02 6F 11
					39 00 00 40 00 00 0B BC 00 00 68 68 10 00 68 68 68 01
					39 00 00 40 00 00 06 F0 55 AA 52 08 04
					39 00 00 40 00 00 02 6F 02
					39 00 00 40 00 00 03 C7 00 42
					39 00 00 40 00 00 02 6F 08
					39 00 00 00 05 00 02 C7 04
					39 00 00 40 00 00 06 F0 55 AA 52 08 04
					39 00 00 40 00 00 02 6F 01
					39 00 00 40 00 00 02 C7 11
					39 00 00 40 00 00 02 6F 02
					39 00 00 40 00 00 07 C7 00 42 00 42 00 42
					39 00 00 40 00 00 02 6F 09
					39 00 00 00 00 00 03 C7 00 42
					39 00 00 40 00 00 02 2F 00
					//GIR_ON need not off
					39 00 00 00 00 00 02 5F 00
					//DBV & BCTRL
					39 00 00 40 00 00 03 51 00 00
					39 00 00 40 00 00 02 6F 04
					39 00 00 40 00 00 03 51 00 00
					39 00 00 40 00 00 02 53 20
					//round conner
					39 00 00 40 00 00 06 F0 55 AA 52 08 07
					39 00 00 40 00 00 02 6F 02
					39 00 00 40 00 00 29 C1 00 00 00 00 00 C7 00 EB 04 38 00 00 04 FF 00 EB 00 00 09 E8 00 CF 0A D4 04 30 09 E8 04 FF 0A D4 02 5B 00 30 02 A4 00 78
					39 00 00 40 00 00 02 6F 36
					39 00 00 40 00 00 37 C4 80 53 0A C0 00 56 0A C4 00 80 0F 0A 7D 00 12 0A 81 00 80 00 0A 25 00 01 0A 48 00 84 A9 0A C0 04 AC 0A C4 00 84 FE 0A 25 04 FF 0A 48 00 84 ED 0A 7D 04 F0 0A 81 00
					39 00 00 40 00 00 03 D0 01 98
					39 00 00 40 00 00 31 D1 00 00 11 EF FF FF ED 10 00 00 00 00 30 13 42 34 E8 82 00 00 00 93 FF FF 90 00 00 00 00 00 30 14 42 34 E7 82 00 00 0C DF FF FF DC C0 00 00 00 00
					39 00 00 40 00 00 03 D0 01 99
					39 00 00 40 00 00 31 D1 30 15 41 34 E7 81 00 00 1E 78 00 00 30 15 42 34 E6 82 00 00 06 C3 FF FF C0 60 00 00 00 00 30 16 41 34 E6 81 00 00 17 5C 00 00 30 16 42 34 E5 82
					39 00 00 40 00 00 03 D0 01 9A
					39 00 00 40 00 00 31 D1 00 00 00 A3 FF FF A0 00 00 00 00 00 30 17 42 34 E4 82 00 00 0E E7 FF FF E4 E0 00 00 00 00 30 18 41 34 E4 81 00 00 1E 78 00 00 30 18 42 34 E3 82
					39 00 00 40 00 00 03 D0 01 9B
					39 00 00 40 00 00 31 D1 00 00 03 BB FF FF B8 30 00 00 00 00 30 19 42 34 E2 82 00 00 13 F7 FF FF F5 30 00 00 00 00 30 19 42 34 E2 82 00 00 00 87 FF FF 84 00 00 00 00 00
					39 00 00 40 00 00 03 D0 01 9C
					39 00 00 40 00 00 31 D1 30 1A 42 34 E1 82 00 00 05 C3 FF FF C0 50 00 00 00 00 30 1B 42 34 E0 82 00 00 13 F7 FF FF F5 30 00 00 00 00 30 1B 42 34 E0 82 00 00 00 83 FF FF
					39 00 00 40 00 00 03 D0 01 9D
					39 00 00 40 00 00 31 D1 80 00 00 00 00 00 30 1C 42 34 DF 82 00 00 02 B3 FF FF B0 20 00 00 00 00 30 1D 42 34 DE 82 00 00 0E E7 FF FF E4 E0 00 00 00 00 30 1E 41 34 DE 81
					39 00 00 40 00 00 03 D0 01 9E
					39 00 00 40 00 00 31 D1 00 00 19 64 00 00 30 1E 42 34 DD 82 00 00 00 93 FF FF 90 00 00 00 00 00 30 1F 42 34 DC 82 00 00 04 BF FF FF BC 40 00 00 00 00 30 20 42 34 DB 82
					39 00 00 40 00 00 03 D0 01 9F
					39 00 00 40 00 00 31 D1 00 00 0E E3 FF FF E0 E0 00 00 00 00 30 21 41 34 DB 81 00 00 17 5C 00 00 30 21 42 34 DA 82 00 00 00 7F FF FF 7C 00 00 00 00 00 30 22 42 34 D9 82
					39 00 00 40 00 00 03 D0 01 A0
					39 00 00 40 00 00 31 D1 00 00 00 9F FF FF 9C 00 00 00 00 00 30 23 42 34 D8 82 00 00 03 BB FF FF B8 30 00 00 00 00 30 24 42 34 D7 82 00 00 0A D3 FF FF D0 A0 00 00 00 00
					39 00 00 40 00 00 03 D0 01 A1
					39 00 00 00 00 00 31 D1 30 25 42 34 D6 82 00 00 0F EB FF FF E8 F0 00 00 00 00 30 26 42 34 D5 82 00 00 14 FF FF FF FD 40 00 00 00 00 30 27 41 34 D5 81 00 00 18 60 00 00
					39 00 00 40 00 00 03 D0 01 A2
					39 00 00 40 00 00 31 D1 30 27 42 34 D4 82 00 00 00 6F FF FF 6C 00 00 00 00 00 30 28 42 34 D3 82 00 00 00 7B FF FF 78 00 00 00 00 00 30 29 42 34 D2 82 00 00 00 7F FF FF
					39 00 00 40 00 00 03 D0 01 A3
					39 00 00 40 00 00 31 D1 7C 00 00 00 00 00 30 2A 42 34 D1 82 00 00 00 83 FF FF 80 00 00 00 00 00 30 2B 42 34 D0 82 00 00 00 83 FF FF 80 00 00 00 00 00 30 2C 42 34 CF 82
					39 00 00 40 00 00 03 D0 01 A4
					39 00 00 40 00 00 31 D1 00 00 00 7F FF FF 7C 00 00 00 00 00 30 2D 42 34 CE 82 00 00 00 7B FF FF 78 00 00 00 00 00 30 2E 42 34 CD 82 00 00 00 6F FF FF 6C 00 00 00 00 00
					39 00 00 40 00 00 03 D0 01 A5
					39 00 00 40 00 00 31 D1 30 2F 42 34 CB 82 00 00 00 63 EF FF F9 80 00 00 00 00 30 30 42 34 CA 82 00 00 00 53 9F FF E5 40 00 00 00 00 30 31 42 34 C9 82 00 00 00 3F 3F FF
					39 00 00 40 00 00 03 D0 01 A6
					39 00 00 40 00 00 31 D1 CC F0 00 00 00 00 30 33 42 34 C8 82 00 00 09 B7 FF FF B4 90 00 00 00 00 30 34 42 34 C7 82 00 00 02 9B FF FF 98 20 00 00 00 00 30 35 42 34 C5 82
					39 00 00 40 00 00 03 D0 01 A7
					39 00 00 40 00 00 31 D1 00 00 00 77 FF FF FD D0 00 00 00 00 30 36 42 34 C4 82 00 00 00 57 6F FF D9 50 00 00 00 00 30 37 42 34 C3 82 00 00 00 2E CF FF B0 B0 00 00 00 00
					39 00 00 40 00 00 03 D0 01 A8
					39 00 00 40 00 00 31 D1 30 38 42 34 C2 82 00 00 00 06 1F FF 84 10 00 00 00 00 30 3A 42 34 C0 82 00 00 00 57 3F FF CD 50 00 00 00 00 30 3B 42 34 BF 82 00 00 00 26 7F FF
					39 00 00 40 00 00 03 D0 01 A9
					39 00 00 40 00 00 31 D1 9C 90 00 00 00 00 30 3C 42 34 BD 82 00 00 00 01 9D BF D9 90 00 00 00 00 30 3E 42 34 BC 82 00 00 00 2E 7F FF 9C B0 00 00 00 00 30 3F 42 34 BA 82
					39 00 00 40 00 00 03 D0 01 AA
					39 00 00 40 00 00 31 D1 00 00 00 01 8C FF CD 80 00 00 00 00 30 40 42 34 B8 82 00 00 00 00 88 BC F2 22 00 00 00 00 30 42 42 34 B7 82 00 00 00 01 1A BF A9 10 00 00 00 00
					39 00 00 40 00 00 03 D0 01 AB
					39 00 00 40 00 00 31 D1 30 43 42 34 B5 82 00 00 00 00 06 31 C5 80 00 00 00 00 30 45 42 34 B3 82 00 00 00 00 67 B5 D5 E1 80 00 00 00 30 47 42 34 B1 82 00 00 00 00 A8 77
					39 00 00 40 00 00 03 D0 01 AC
					39 00 00 40 00 00 31 D1 DE 12 80 00 00 00 30 48 43 34 AF 83 00 00 00 00 03 22 DF FF FF DE 23 00 00 00 00 00 00 00 30 4A 43 34 AD 83 00 00 00 00 03 21 DB FF FF DA 13 00
					39 00 00 40 00 00 03 D0 01 AD
					39 00 00 40 00 00 31 D1 00 00 00 00 00 00 30 4C 43 34 AB 83 00 00 00 00 02 DF CB FF FF C9 F2 C0 00 00 00 00 00 00 30 4D 43 34 A9 83 00 00 00 00 00 08 6E DF FF 95 B2 00
					39 00 00 40 00 00 03 D0 01 AE
					39 00 00 40 00 00 31 D1 00 00 00 00 00 00 30 4F 43 34 A6 83 00 00 00 00 00 03 56 5F BF FA 53 00 00 00 00 00 00 00 30 51 43 34 A4 83 00 00 3F FC 00 00 2E 2E 7F E6 22 C0
					39 00 00 40 00 00 03 D0 01 AF
					39 00 00 40 00 00 31 D1 00 0F FF 00 00 00 30 53 43 34 A2 83 00 00 00 00 00 00 19 CC 7F C5 C1 80 00 00 00 00 00 00 30 55 43 34 9F 83 00 00 00 00 00 00 01 39 FB EE 74 C0
					39 00 00 40 00 00 03 D0 01 B0
					39 00 00 40 00 00 31 D1 00 00 00 00 00 00 30 57 43 34 9D 83 00 00 00 00 00 00 00 86 EE B9 B2 00 00 00 00 00 00 00 30 5A 43 34 9A 83 00 00 00 00 00 00 00 D7 B0 C1 E3 40
					39 00 00 40 00 00 03 D0 01 B1
					39 00 00 40 00 00 31 D1 00 00 00 00 00 00 30 5C 44 34 96 84 00 00 00 00 00 00 00 03 5E BB EF FF FA E7 8D 00 00 00 00 00 00 00 00 00 30 5F 44 34 93 84 00 00 00 00 00 00
					39 00 00 00 00 00 03 D0 01 B2
					39 00 00 40 00 00 31 D1 00 02 9A A7 7F FF DE 96 8A 00 00 00 00 00 00 00 00 00 30 61 44 34 8F 84 00 00 00 00 00 00 00 00 04 4A 0B BB EE E8 12 10 00 00 00 00 00 00 00 00
					39 00 00 40 00 00 03 D0 01 B3
					39 00 00 40 00 00 31 D1 30 64 45 34 8B 85 00 00 00 00 00 00 00 00 00 21 58 AF EF FF FF EE F8 95 20 00 00 00 00 00 00 00 00 00 00 00 30 67 45 34 87 85 00 00 00 00 00 00
					39 00 00 40 00 00 03 D0 01 B4
					39 00 00 40 00 00 31 D1 00 00 00 00 85 20 AF 6F FF DA B8 14 20 00 00 00 00 00 00 00 00 00 00 00 30 6A 45 34 82 85 00 00 00 00 00 00 00 00 00 00 00 CE 66 4B B9 E6 E9 19
					39 00 00 40 00 00 03 D0 01 B5
					39 00 00 40 00 00 31 D1 38 30 00 00 00 00 00 00 00 00 00 00 30 6E 46 34 7C 86 00 00 00 00 00 00 00 00 00 00 00 05 3D 98 EC DB FF FF FF 6B 23 64 F1 40 00 00 00 00 00 00
					39 00 00 40 00 00 03 D0 01 B6
					39 00 00 40 00 00 31 D1 00 00 00 00 00 00 30 71 47 34 76 87 00 00 00 00 00 00 00 00 00 00 00 00 00 23 15 76 6B B7 FF FF FF FF 7B A6 75 53 02 00 00 00 00 00 00 00 00 00
					39 00 00 40 00 00 03 D0 01 B7
					39 00 00 40 00 00 31 D1 00 00 00 00 00 00 30 75 47 34 70 87 00 00 00 00 00 00 00 00 00 00 00 00 00 00 03 31 46 E3 AF 2E 7F E7 2A E3 6D 43 03 00 00 00 00 00 00 00 00 00
					39 00 00 40 00 00 03 D0 01 B8
					39 00 00 40 00 00 31 D1 00 00 00 00 00 00 30 7A 48 34 68 88 00 00 00 00 00 00 00 00 00 00 00 00 00 00 00 00 63 54 6E 2A 6F D7 CF FF F3 5B E9 89 B5 0D 18 00 00 00 00 00
					39 00 00 40 00 00 03 D0 01 B9
					39 00 00 40 00 00 31 D1 00 00 00 00 00 00 00 00 00 00 00 00 30 7F 49 34 5F 89 00 00 00 00 00 00 00 00 00 00 00 00 00 00 00 00 00 02 24 F5 5B 86 6B 31 DF CF FF F3 7C 6C
					39 00 00 40 00 00 03 D0 01 BA
					39 00 00 40 00 00 31 D1 9A 16 D5 3C 90 80 00 00 00 00 00 00 00 00 00 00 00 00 00 00 00 00 00 00 30 85 4A 34 54 8A 00 00 00 00 00 00 00 00 00 00 00 00 00 00 00 00 00 00
					39 00 00 40 00 00 03 D0 01 BB
					39 00 00 40 00 00 31 D1 00 01 09 39 36 1D 8A 7A F0 D3 9F 7F F7 9D 30 AE 78 9D 61 33 89 10 00 00 00 00 00 00 00 00 00 00 00 00 00 00 00 00 00 00 00 00 30 8C 4C 34 46 8C
					39 00 00 40 00 00 03 D0 01 BC
					39 00 00 40 00 00 31 D1 00 00 00 00 00 00 00 00 00 00 00 00 00 00 00 00 00 00 00 00 00 00 11 4A 39 25 9A 7A 19 69 B3 0C F7 EB DF FF F7 AD F3 C2 CA 65 85 E6 96 48 E2 85
					39 00 00 40 00 00 03 D0 01 BD
					39 00 00 40 00 00 31 D1 04 00 00 00 00 00 00 00 00 00 00 00 00 00 00 00 00 00 00 00 00 00 00 00 30 96 4F 34 31 8F 00 00 00 00 00 00 00 00 00 00 00 00 00 00 00 00 00 00
					39 00 00 40 00 00 03 D0 01 BE
					39 00 00 40 00 00 31 D1 00 00 00 00 00 00 00 31 CA 35 04 D6 65 B7 A1 8E 6A 2B B6 FC B4 DB 8E BC FB FF FF FB CE B8 DB 4C AF B6 BA 26 8E 17 9B 65 64 D0 34 A1 C3 00 00 00
					39 00 00 40 00 00 03 D0 01 BF
					39 00 00 40 00 00 31 D1 00 00 00 00 00 00 00 00 00 00 00 00 00 00 00 00 00 00 00 00 00 00 00 00 00 00 00 00 00 00 00 00 00 00 00 00 00 00 00 00 00 00 00 00 00 00 00 00
					39 00 00 00 00 00 02 D0 00
					//ambi_temp 25C
					39 00 00 00 00 00 03 81 03 19
					/* Display On */
					05 00 00 00 78 00 01 11
					05 00 00 00 00 00 01 29
					/* BRS reload*/
					39 00 00 40 00 00 06 A3 81 84 38 2A AE
					39 00 00 40 00 00 02 6F 05
					39 00 00 40 00 00 08 A3 02 04 B5 02 03 00 04
					39 00 00 40 00 00 02 6F 12
					39 00 00 40 00 00 07 A3 01 00 9D 00 00 AA
					39 00 00 40 00 00 02 6F 2C
					39 00 00 40 00 00 08 A3 02 04 B5 02 03 00 08
					39 00 00 40 00 00 02 6F 39
					39 00 00 40 00 00 07 A3 01 00 9D 00 00 AA
					39 00 00 40 00 00 02 6F 53
					39 00 00 40 00 00 08 A3 02 04 B5 02 03 00 10
					39 00 00 40 00 00 02 6F 60
					39 00 00 40 00 00 07 A3 01 00 9D 00 00 AA
					//csc enable
					39 00 00 00 00 00 07 A9 02 09 B0 25 25 07
				];
				qcom,mdss-dsi-on-command-state = "dsi_lp_mode";
				/* FPS Switch Setting */
				mi,mdss-dsi-fps-120-gamma-command = [
					39 00 00 00 00 00 02 2F 00
				];
				mi,mdss-dsi-fps-120-gamma-command-state = "dsi_hs_mode";
				mi,mdss-dsi-fps-90-gamma-command = [
					39 00 00 00 00 00 02 2F 01
				];
				mi,mdss-dsi-fps-90-gamma-command-state = "dsi_hs_mode";
				mi,mdss-dsi-fps-60-gamma-command = [
					39 00 00 00 00 00 19 A9 02 01 B9 1E 1E B8 01 00 A2 00 06 75 02 01 B9 1E 1E C2 01 00 2F 00 00 02
				];
				mi,mdss-dsi-fps-60-gamma-command-state = "dsi_hs_mode";
				//AOD
				qcom,mdss-dsi-nolp-command = [
					39 00 00 40 00 00 02 6F 04
					39 00 00 40 00 00 03 51 00 00
					05 00 00 00 00 00 01 38
				];
				qcom,mdss-dsi-nolp-command-update = <0x51 1 2>;
				qcom,mdss-dsi-nolp-command-state = "dsi_hs_mode";
				mi,mdss-dsi-aod-enter-command = [
					05 00 00 00 00 00 01 39
				];
				mi,mdss-dsi-aod-enter-command-state = "dsi_hs_mode";

				mi,mdss-dsi-doze-hbm-command = [
					39 00 00 40 00 00 03 51 03 28
					15 00 00 40 00 00 02 6F 04
					39 00 00 00 00 00 03 51 3F FF
				];
				mi,mdss-dsi-doze-hbm-command-state = "dsi_hs_mode";

				mi,mdss-dsi-doze-lbm-command = [
					39 00 00 40 00 00 03 51 00 38
					39 00 00 40 00 00 02 6F 04
					39 00 00 00 00 00 03 51 05 55
				];
				mi,mdss-dsi-doze-lbm-command-state = "dsi_hs_mode";

				mi,mdss-dsi-aod-exit-command = [
					05 00 00 00 00 00 01 38
				];
				mi,mdss-dsi-aod-exit-command-state = "dsi_hs_mode";

				mi,mdss-dsi-doze-hbm-nolp-command = [
					39 00 00 00 00 00 03 51 03 28
				];
				mi,mdss-dsi-doze-hbm-nolp-command-state = "dsi_hs_mode";

				mi,mdss-dsi-doze-lbm-nolp-command = [
					39 00 00 00 00 00 03 51 00 38
				];
				mi,mdss-dsi-doze-lbm-nolp-command-state = "dsi_hs_mode";

				//lhbm code
				mi,mdss-dsi-local-hbm-normal-white-1000nit-command = [
					/*1200nit default D1*/
					39 00 00 40 00 00 06 F0 55 AA 52 08 02
					39 00 00 40 00 00 07 D1 24 C0 22 08 29 AC
					/*FPR ON*/
					39 00 00 40 00 00 02 6F 01
					39 00 00 40 00 00 02 8B 01
					39 00 00 00 00 00 02 87 25
				];
				mi,mdss-dsi-local-hbm-normal-white-1000nit-command-update = <0xD1 1 6>;
				mi,mdss-dsi-local-hbm-normal-white-1000nit-command-state = "dsi_hs_mode";
				mi,mdss-dsi-local-hbm-hlpm-white-1000nit-command = [
					/*1200nit default D1*/
					39 00 00 40 00 00 06 F0 55 AA 52 08 02
					39 00 00 40 00 00 07 D1 24 C0 22 08 29 AC
					/*FPR ON*/
					39 00 00 00 00 00 13 A9 01 00 38 00 00 00 01 00 8B 01 01 01 01 00 87 00 00 25
				];
				mi,mdss-dsi-local-hbm-hlpm-white-1000nit-command-update = <0xD1 1 6>;
				mi,mdss-dsi-local-hbm-hlpm-white-1000nit-command-state = "dsi_hs_mode";
				mi,mdss-dsi-local-hbm-normal-white-110nit-command = [
					/*200nit default D1*/
					39 00 00 40 00 00 06 F0 55 AA 52 08 02
					39 00 00 40 00 00 07 D1 1A E0 19 68 20 00
					/*FPR ON*/
					39 00 00 40 00 00 02 6F 01
					39 00 00 40 00 00 02 8B 01
					39 00 00 00 00 00 02 87 25
				];
				mi,mdss-dsi-local-hbm-normal-white-110nit-command-update = <0xD1 1 6>;
				mi,mdss-dsi-local-hbm-normal-white-110nit-command-state = "dsi_hs_mode";
				mi,mdss-dsi-local-hbm-hlpm-white-110nit-command = [
					/*200nit default D1*/
					39 00 00 40 00 00 06 F0 55 AA 52 08 02
					39 00 00 40 00 00 07 D1 1A E0 19 68 20 00
					/*FPR ON*/
					39 00 00 00 00 00 13 A9 01 00 38 00 00 00 01 00 8B 01 01 01 01 00 87 00 00 25
				];
				mi,mdss-dsi-local-hbm-hlpm-white-110nit-command-update = <0xD1 1 6>;
				mi,mdss-dsi-local-hbm-hlpm-white-110nit-command-state = "dsi_hs_mode";
				mi,mdss-dsi-local-hbm-off-to-normal-command = [
					/*FPR OFF*/
					39 00 00 40 00 00 02 87 00
					39 00 00 40 00 00 02 6F 01
					39 00 00 00 00 00 02 8B 00
				];
				mi,mdss-dsi-local-hbm-off-to-normal-command-state = "dsi_hs_mode";
				mi,mdss-dsi-local-hbm-off-to-hbm-command = [
					/*FPR OFF*/
					39 00 00 40 00 00 02 87 00
					39 00 00 40 00 00 02 6F 01
					39 00 00 00 00 00 02 8B 00
				];
				mi,mdss-dsi-local-hbm-off-to-hbm-command-state = "dsi_hs_mode";
			};
		};
	};
};
&dsi_p16u_42_02_0a_dsc_vid {
	qcom,panel-supply-entries = <&dsi_panel_pwr_supply_p16u>;
	qcom,mdss-dsi-bl-pmic-control-type = "bl_ctrl_dcs";
	qcom,mdss-dsi-bl-min-level = <15>;
	qcom,mdss-dsi-bl-max-level = <16383>;
	qcom,mdss-brightness-max-level = <16383>;
	qcom,mdss-brightness-init-level = <1228>;
	qcom,mdss-dsi-bl-inverted-dbv;
	qcom,platform-reset-gpio = <&tlmm 12 0>;
	mi,disable-ic-dimming-flag;

	qcom,ulps-enabled;
	qcom,dsi-select-clocks = "pll_byte_clk0", "pll_dsi_clk0";
	qcom,mdss-dsi-clk-strength = <0xFF>;

	mi,panel-id = <0x50313655 0x0042020A>;
	mi,panel-on-dimming-delay = <120>;
	mi,max-brightness-clone = <16383>;
	mi,mdss-dsi-fac-bl-max-level = <10926>;
	mi,mdss-fac-brightness-max-level = <10926>;
	mi,thermal-dimming-flag;
	/* IRQF_ONESHOT | IRQF_TRIGGER_HEIGH */
	mi,esd-err-irq-gpio = <&tlmm 149 0x2004>;
	mi,panel-ignore-esd-in-aod;

	mi,is-tddi-flag;//for double click
	/* AOD CONFIG*/
	mi,doze-hbm-dbv-level = <808>;
	mi,doze-lbm-dbv-level = <56>;

	mi,ddic-round-corner-enabled;

	//lhbm
	mi,local-hbm-enabled;
	mi,need-fod-animal-in-normal-enabled;
	mi,local-hbm-ui-ready-delay-num-frame = <3>; /* 3 frame */
	mi,local-hbm-update-with-hbm-mode-threshold = <16383>;
};
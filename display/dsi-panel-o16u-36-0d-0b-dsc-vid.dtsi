
&mdss_mdp {
	dsi_o16u_36_0d_0b_dsc_vid: qcom,mdss_dsi_o16u_36_0d_0b_dsc_vid {
		qcom,mdss-dsi-panel-name = "xiaomi o16u 36 0d 0b video mode dsc dsi panel";
		qcom,mdss-dsi-panel-type = "dsi_video_mode";
		qcom,mdss-dsi-virtual-channel-id = <0>;
		qcom,mdss-dsi-stream = <0>;
		qcom,mdss-dsi-bpp = <30>;
		qcom,mdss-dsi-color-order = "rgb_swap_rgb";
		qcom,mdss-dsi-underflow-color = <0xff>;
		qcom,mdss-dsi-border-color = <0>;
		qcom,dsi-ctrl-num = <0>;
		qcom,dsi-phy-num = <0>;
		qcom,mdss-dsi-traffic-mode = "burst_mode";
		qcom,mdss-dsi-lane-map = "lane_map_0123";
		qcom,mdss-dsi-bllp-eof-power-mode;
		qcom,mdss-dsi-bllp-power-mode;
		qcom,mdss-dsi-lane-0-state;
		qcom,mdss-dsi-lane-1-state;
		qcom,mdss-dsi-lane-2-state;
		qcom,mdss-dsi-lane-3-state;
		qcom,mdss-dsi-dma-trigger = "trigger_sw";
		qcom,mdss-dsi-mdp-trigger = "none";
		qcom,mdss-dsi-reset-sequence =<1 20>, <0 5>, <1 20>;
		qcom,mdss-pan-physical-width-dimension = <695>;
		qcom,mdss-pan-physical-height-dimension = <1545>;
		qcom,mdss-dsi-tx-eot-append;
		qcom,mdss-dsi-lp11-init;
		qcom,mdss-dsi-bl-inverted-dbv;
		qcom,bl-update-flag = "delay_until_first_frame";
		qcom,mdss-dsi-panel-hdr-enabled;
		qcom,mdss-dsi-panel-hdr-color-primaries = <14500 15500 32000
			17000 15500 30000 8000 3000>;
		qcom,mdss-dsi-panel-peak-brightness = <10000000>;
		qcom,mdss-dsi-panel-blackness-level = <220>;

		mi,mdss-dsi-panel-wp-read-command = [06 01 00 01 00 00 01 A1];
		mi,mdss-dsi-panel-wp-read-command-state = "dsi_hs_mode";
		mi,mdss-dsi-panel-wp-read-length = <3>;

		mi,flatmode-status-check-enabled;
		mi,mdss-dsi-panel-flatmode-status-offset-command = [
			39 00 00 00 00 00 03 F0 AA 11
		];
		mi,mdss-dsi-panel-flatmode-status-offset-command-state = "dsi_hs_mode";
		mi,mdss-dsi-panel-flatmode-status-command = [
			06 01 00 01 00 00 01 D5
		];
		mi,mdss-dsi-panel-flatmode-status-command-state = "dsi_hs_mode";
		mi,mdss-dsi-panel-flatmode-status-offset-end-command = [
			39 00 00 00 00 00 03 F0 AA 00
		];
		mi,mdss-dsi-panel-flatmode-status-offset-end-command-state = "dsi_hs_mode";
		mi,mdss-dsi-panel-flatmode-status-read-length = <1>;
		mi,mdss-dsi-panel-flatmode-on-status-value = <0x13>;

		qcom,mdss-dsi-pan-enable-dynamic-fps;
		qcom,mdss-dsi-pan-fps-update =
		 	"dfps_immediate_porch_mode_vfp";
		qcom,dsi-supported-dfps-list = <120 90 60 30>;
		qcom,mdss-dsi-display-timings {
			timing@0{
				qcom,mdss-dsi-video-mode;
				qcom,mdss-dsi-panel-framerate = <120>;
				qcom,mdss-dsi-panel-width = <1220>;
				qcom,mdss-dsi-panel-height = <2712>;
				qcom,mdss-dsi-h-front-porch = <90>;
				qcom,mdss-dsi-h-back-porch = <16>;
				qcom,mdss-dsi-h-pulse-width = <16>;
				qcom,mdss-dsi-h-sync-skew = <0>;
				qcom,mdss-dsi-v-back-porch = <12>;
				qcom,mdss-dsi-v-front-porch = <24>;
				qcom,mdss-dsi-v-pulse-width = <4>;
				qcom,mdss-dsi-h-sync-pulse = <0>;
				qcom,mdss-dsi-h-left-border = <0>;
				qcom,mdss-dsi-h-right-border = <0>;
				qcom,mdss-dsi-v-top-border = <0>;
				qcom,mdss-dsi-v-bottom-border = <0>;
				qcom,mdss-dsi-panel-clockrate = <1111460000>;
				qcom,mdss-dsi-on-command = [
					/*compression mode*/
					39 00 00 40 00 00 02 03 01
					39 00 00 40 00 00 02 35 00
					39 00 00 40 00 00 02 53 20
					39 00 00 40 00 00 03 51 00 00
					/*DEMURA ON*/
					39 00 00 40 00 00 02 59 09
					39 00 00 40 00 00 02 5D 00
					39 00 00 40 00 00 02 6F 01
					39 00 00 00 00 00 02 6C 02
					/*RU code*/
					39 00 00 40 00 00 03 F0 AA 18
					39 00 00 40 00 00 0F B0 19 96 00 1E 02 F4 06 D0 78 D7 E8 06 00 00
					39 00 00 40 00 00 0C B1 96 00 1E 02 F4 07 CF 78 D8 10 8E
					39 00 00 40 00 00 10 C0 50 3E 39 17 39 C4 71 C0 C3 72 AA 15 4C B5 68
					39 00 00 40 00 00 10 C1 47 A4 12 29 24 99 D1 28 95 3B 1D 8E E7 73 B8
					39 00 00 40 00 00 10 C2 3B 9E 0F 07 83 C1 E0 F0 58 2C 16 0E E7 72 B8
					39 00 00 40 00 00 10 C3 2B 95 CE C5 62 B1 54 AA 74 2A 15 0A 65 32 90
					39 00 00 40 00 00 10 C4 29 14 4A 25 02 81 3C 9E 4E 26 93 49 84 B2 58
					39 00 00 40 00 00 10 C5 25 12 89 24 81 41 1C 8C 45 22 91 08 62 32 10
					39 00 00 40 00 00 10 C6 20 90 04 05 F2 F1 74 B8 5C 2D 96 8B 25 81 C0
					39 00 00 40 00 00 10 C7 1B 8D 86 A5 42 98 CC 64 31 18 0B C5 C4 D2 60
					39 00 00 40 00 00 10 C8 25 92 89 24 81 40 9C 4C 25 12 10 C8 44 12 00
					39 00 00 40 00 00 10 C9 2F 97 8B A5 C2 D9 68 B2 58 1C 0D C6 C3 51 A0
					39 00 00 40 00 00 10 CA 19 8C 86 23 01 78 B8 5A 2C 15 8A 85 22 81 38
					39 00 00 40 00 00 10 CB 13 09 44 82 31 10 84 40 00 00 00 00 00 00 00
					39 00 00 40 00 00 10 E0 08 40 B4 9C A2 62 08 04 91 A7 0A 86 B2 30 8C
					39 00 00 40 00 00 10 E1 22 C4 90 19 A3 4B CA B0 15 70 22 5C 23 AE 03
					39 00 00 40 00 00 10 E2 43 20 33 29 A0 19 D4 D8 4E B8 11 4E A6 3A 12
					39 00 00 40 00 00 10 E3 00 88 63 A5 6C 74 22 11 0C A6 39 D0 A5 B1 AD
					39 00 00 40 00 00 10 E4 73 E1 19 4E 94 AD AF 7C 67 3A DE F9 DE FB DF
					39 00 00 40 00 00 10 E5 6B 59 8B 52 4F D5 A4 EB CB 96 86 65 A9 EE 9B
					39 00 00 40 00 00 10 E6 9E A5 98 5B B3 CF EB B8 5B 60 AE BF 3C 70 14
					39 00 00 40 00 00 10 E7 C7 01 3B EF D1 A6 37 E0 00 00 DF 40 00 00 00
					39 00 00 40 00 00 10 E8 A5 B1 AE 78 00 00 01 2A 56 D8 CE B7 CE FB F9
					39 00 00 40 00 00 10 E9 CE 40 00 7F A0 00 38 00 00 1F 00 00 00 00 00
					39 00 00 40 00 00 02 65 0C
					39 00 00 40 00 00 02 B0 01
					39 00 00 40 00 00 10 C0 70 4D C0 F9 2B BD 6E 3E E2 62 B1 D9 2A B6 60
					39 00 00 40 00 00 10 C1 57 2B D6 0B 14 92 4D 28 94 4A A5 4E C9 63 B8
					39 00 00 40 00 00 10 C2 3B 9D CE E7 73 B9 DC EE 77 3B 9D CE E5 72 B8
					39 00 00 40 00 00 10 C3 3B 1D 8A C7 53 A9 54 E8 54 2A 1C CA 67 22 90
					39 00 00 40 00 00 10 C4 38 94 4E 05 03 79 3C 9C 4E 26 9B 09 84 B2 58
					39 00 00 40 00 00 10 C5 25 12 49 24 82 39 1C 8C 45 22 91 08 66 22 10
					39 00 00 40 00 00 10 C6 20 90 0F E5 F2 F1 74 B8 7B 2D 96 8B 25 82 B8
					39 00 00 40 00 00 10 C7 1B 8D 8A A5 42 99 48 64 31 18 0B C9 C4 D2 60
					39 00 00 40 00 00 10 C8 25 92 89 24 82 38 9C 4C 45 22 10 C8 44 12 00
					39 00 00 40 00 00 10 C9 2F 97 8B A5 C2 D9 68 B2 58 2B 8D C6 C3 51 A0
					39 00 00 40 00 00 10 CA 19 8C 86 23 01 78 B8 5A 2C 15 8A 85 22 81 38
					39 00 00 40 00 00 10 CB 13 09 44 82 31 10 84 40 00 00 00 00 00 00 00
					39 00 00 40 00 00 10 E0 4A 50 73 10 4B 41 42 A3 05 45 61 C2 81 24 49
					39 00 00 40 00 00 10 E1 12 02 76 95 42 3B 48 97 11 2E 22 1A 23 2C 04
					39 00 00 40 00 00 10 E2 3A C0 33 A9 A1 21 D4 D7 CA A1 19 90 A6 3A 00
					39 00 00 40 00 00 10 E3 10 CA 74 29 8D 70 02 32 14 C7 42 54 B5 B1 AE
					39 00 00 40 00 00 10 E4 7C 23 29 CE 95 AD AF 8C 67 5A DE F9 DE FB DF
					39 00 00 40 00 00 10 E5 A5 27 38 C1 D7 A4 5D 69 3A D1 CD 1D 67 DE 17
					39 00 00 40 00 00 10 E6 85 9F 5D CF 30 B6 E5 7E 4F 1C 95 F7 1A E5 D2
					39 00 00 40 00 00 10 E7 B6 9F 2A E7 90 9D B3 CF 00 17 D7 3C 00 00 12
					39 00 00 40 00 00 10 E8 A5 B1 9D F3 C0 04 23 2A 56 D7 C6 75 BE 77 DF
					39 00 00 40 00 00 10 E9 F7 BD EE EF 20 07 74 0F EC 1E 00 36 0E 83 A0
					39 00 00 40 00 00 10 EA E8 38 00 00 1E 00 00 00 00 00 00 00 00 03 A0
					39 00 00 00 00 00 10 EB 00 3A 00 00 1F 00 00 00 00 00 00 00 00 00 00
					/*PMIC PULSE fixed the AOD flash*/
					39 00 00 40 00 00 03 F0 AA 10
					39 00 00 00 00 00 1B D0 84 24 90 14 C0 00 2F 4B 11 4F 00 00 4B 2C 4F 00 00 00 04 44 11 11 11 00 00 00
					/*Active High Error Low*/
					39 00 00 40 00 00 03 F0 AA 10
					39 00 00 40 00 00 02 65 01
					39 00 00 40 00 00 02 CF 87
					39 00 00 40 00 00 02 65 08
					39 00 00 00 00 00 02 CF 0F
					/*video trim*/
					39 00 00 40 00 00 03 F0 AA 12
					39 00 00 40 00 00 04 C3 E1 20 50
					39 00 00 40 00 00 02 65 11
					39 00 00 40 00 00 0F C3 00 63 00 63 00 63 00 63 00 63 00 63 00 63
					39 00 00 40 00 00 11 CC 2B 1D 2B 1D 2B 1D 2B 1D 2B 1D 2B 1D 2B 1D 04 BF
					39 00 00 40 00 00 03 FF 5A 80
					39 00 00 40 00 00 02 65 0A
					39 00 00 40 00 00 02 F9 A8
					39 00 00 40 00 00 03 F0 AA 10
					39 00 00 40 00 00 08 B0 05 4C 01 31 01 04 C4
					39 00 00 40 00 00 02 65 02
					39 00 00 40 00 00 04 D0 90 14 C0
					39 00 00 40 00 00 04 B8 32 00 0A
					39 00 00 40 00 00 04 B9 01 18 00
					39 00 00 40 00 00 03 F0 AA 11
					39 00 00 40 00 00 02 65 02
					39 00 00 40 00 00 03 D5 66 66
					39 00 00 40 00 00 02 D5 13
					39 00 00 40 00 00 03 F0 AA 12
					39 00 00 40 00 00 02 65 02
					39 00 00 40 00 00 02 D1 00
					39 00 00 40 00 00 03 FF 5A 81
					39 00 00 40 00 00 02 65 02
					39 00 00 40 00 00 02 F4 27
					39 00 00 40 00 00 02 65 19
					39 00 00 40 00 00 02 F8 01
					39 00 00 40 00 00 02 65 03
					39 00 00 40 00 00 04 FB F3 F3 F3
					39 00 00 40 00 00 03 F0 AA 12
					39 00 00 00 00 00 02 DF 41
					/*Delay 120ms*/
					39 00 00 00 78 00 02 11 00
					39 00 00 40 00 00 03 F0 AA 12
					39 00 00 00 00 00 02 DF 11
					39 00 00 40 00 00 03 F0 AA 00
					39 00 00 00 00 00 03 FF 5A 00
					/* Display On */
					39 00 00 00 00 00 02 29 00
				];
				qcom,mdss-dsi-off-command = [
					05 00 00 00 0A 00 02 28 00
					05 00 00 00 78 00 02 10 00
				];
				qcom,mdss-dsi-on-command-state = "dsi_lp_mode";
				qcom,mdss-dsi-off-command-state = "dsi_lp_mode";
				qcom,compression-mode = "dsc";
				qcom,mdss-dsc-version = <0x12>;
				qcom,mdss-dsc-scr-version = <0x0>;
				qcom,mdss-dsc-slice-height = <12>;
				qcom,mdss-dsc-slice-width = <610>;
				qcom,mdss-dsc-slice-per-pkt = <2>;
				qcom,mdss-dsc-bit-per-component = <10>;
				qcom,mdss-dsc-bit-per-pixel = <8>;
				qcom,mdss-dsc-block-prediction-enable;
			};
		};
	};
};
&dsi_o16u_36_0d_0b_dsc_vid {
	mi,panel-id = <0x4F313655 0x00360D0B>;
	mi,max-brightness-clone = <20479>;
	mi,normal-max-brightness-clone = <4095>;
	mi,mdss-dsi-fac-bl-max-level = <2047>;
	mi,mdss-fac-brightness-max-level = <2047>;
	mi,thermal-dimming-flag;
	mi,panel-on-dimming-delay = <120>;
	//qcom,mdss-dsi-panel-dimming-enabled;
	mi,flatmode-default-on-enabled;
	mi,ddic-round-corner-enabled;
	mi,local-hbm-enabled;
	mi,need-fod-animal-in-normal-enabled;
	mi,local-hbm-ui-ready-delay-num-frame = <3>; /* 1 frame */
	/* IRQF_ONESHOT | IRQF_TRIGGER_LOW */
	mi,esd-err-irq-gpio = <&tlmm 149 0x2008>;
	mi,panel-ignore-esd-in-aod;
	/* AOD CONFIG*/
	mi,doze-hbm-dbv-level = <245>;
	mi,doze-lbm-dbv-level = <20>;
	qcom,mdss-dsi-display-timings {
		timing@0{
			/*flat mode*/
			mi,mdss-dsi-flat-mode-on-command = [
				39 00 00 40 00 00 03 F0 AA 11
				39 00 00 40 00 00 02 D5 13
				39 00 00 00 00 00 03 F0 AA 00
			];
			mi,mdss-dsi-flat-mode-on-command-state = "dsi_hs_mode";

			mi,mdss-dsi-flat-mode-off-command = [
				39 00 00 40 00 00 03 F0 AA 11
				39 00 00 40 00 00 02 D5 12
				39 00 00 00 00 00 03 F0 AA 00
			];
			mi,mdss-dsi-flat-mode-off-command-state = "dsi_hs_mode";
			/* FPS Switch Setting */
			mi,mdss-dsi-fps-120-gamma-command = [
				39 00 00 00 00 00 02 6C 02
			];
			mi,mdss-dsi-fps-120-gamma-command-state = "dsi_hs_mode";
			mi,mdss-dsi-fps-90-gamma-command = [
				39 00 00 00 00 00 02 6C 01
			];
			mi,mdss-dsi-fps-90-gamma-command-state = "dsi_hs_mode";
			mi,mdss-dsi-fps-60-gamma-command = [
				39 00 00 00 00 00 02 6C 00
			];
			mi,mdss-dsi-fps-60-gamma-command-state = "dsi_hs_mode";

			qcom,mdss-dsi-nolp-command = [
				39 00 00 00 00 00 03 51 00 00
			];
			qcom,mdss-dsi-nolp-command-update = <0x51 0 2>;
			qcom,mdss-dsi-nolp-command-state = "dsi_hs_mode";
			mi,mdss-dsi-aod-enter-command = [
				05 00 00 00 00 00 01 39
			];
			mi,mdss-dsi-aod-enter-command-state = "dsi_hs_mode";

			mi,mdss-dsi-doze-hbm-command = [
				39 00 00 40 00 00 03 51 00 FC
				15 00 00 00 00 00 02 6D 01
			];
			mi,mdss-dsi-doze-hbm-command-state = "dsi_hs_mode";

			mi,mdss-dsi-doze-lbm-command = [
				39 00 00 40 00 00 03 51 00 14
				15 00 00 00 00 00 02 6D 00
			];
			mi,mdss-dsi-doze-lbm-command-state = "dsi_hs_mode";

			mi,mdss-dsi-aod-exit-command = [
				05 00 00 00 00 00 01 38
			];
			mi,mdss-dsi-aod-exit-command-state = "dsi_hs_mode";

			mi,mdss-dsi-doze-hbm-nolp-command = [
				39 00 00 00 00 00 03 51 00 FC
			];
			mi,mdss-dsi-doze-hbm-nolp-command-state = "dsi_hs_mode";

			mi,mdss-dsi-doze-lbm-nolp-command = [
				39 00 00 00 00 00 03 51 00 14
			];
			mi,mdss-dsi-doze-lbm-nolp-command-state = "dsi_hs_mode";
			//rounc corner
			mi,mdss-dsi-round-corner-on-command = [
				39 00 00 40 00 00 03 F0 AA 18
				15 00 00 40 00 00 02 B0 19
				39 00 00 00 00 00 03 F0 AA 00
			];
			mi,mdss-dsi-round-corner-on-command-state = "dsi_lp_mode";
			mi,mdss-dsi-round-corner-off-command = [
				39 00 00 40 00 00 03 F0 AA 18
				15 00 00 40 00 00 02 B0 00
				39 00 00 00 00 00 03 F0 AA 00
			];
			mi,mdss-dsi-round-corner-off-command-state = "dsi_lp_mode";
			//lhbm
			mi,mdss-dsi-local-hbm-normal-white-1000nit-command = [
				39 00 00 00 00 00 03 51 07 FF
				39 00 00 40 00 00 03 F0 AA 13
				39 00 00 40 00 00 13 C5 00 00 00 00 00 00 00 00 00 00 00 00 00 00 00 00 00 00
				39 00 00 40 00 00 05 63 10 00 00 00
				39 00 00 40 00 00 02 62 03
				39 00 00 00 00 00 03 F0 AA 00
			];
			mi,mdss-dsi-local-hbm-normal-white-1000nit-command-update = <0x51 0 2>, <0xC5 2 18>, <0x63 3 4>;
			mi,mdss-dsi-local-hbm-normal-white-1000nit-command-state = "dsi_hs_mode";
			mi,mdss-dsi-local-hbm-hlpm-white-1000nit-command = [
				/* nolp */
				05 00 00 00 00 00 01 38
				/* lhbm setting */
				39 00 00 40 00 00 03 F0 AA 13
				39 00 00 40 00 00 13 C5 00 00 00 00 00 00 00 00 00 00 00 00 00 00 00 00 00 00
				39 00 00 40 00 00 05 63 10 00 00 00
				39 00 00 40 00 00 02 62 03
				39 00 00 00 00 00 03 F0 AA 00
			];
			mi,mdss-dsi-local-hbm-hlpm-white-1000nit-command-update = <0xC5 2 18>, <0x63 3 4>;
			mi,mdss-dsi-local-hbm-hlpm-white-1000nit-command-state = "dsi_hs_mode";

			mi,mdss-dsi-local-hbm-normal-white-110nit-command = [
				39 00 00 40 00 00 03 F0 AA 13
				39 00 00 40 00 00 13 C5 00 00 00 00 00 00 00 00 00 00 00 00 00 00 00 00 00 00
				39 00 00 40 00 00 05 63 10 00 00 00
				39 00 00 40 00 00 02 62 03
				39 00 00 00 00 00 03 F0 AA 00
			];
			mi,mdss-dsi-local-hbm-normal-white-110nit-command-update = <0xC5 1 18>, <0x63 2 4>;
			mi,mdss-dsi-local-hbm-normal-white-110nit-command-state = "dsi_hs_mode";
			mi,mdss-dsi-local-hbm-hlpm-white-110nit-command = [
				/* nolp */
				05 00 00 00 00 00 01 38
				/* lhbm setting */
				39 00 00 40 00 00 03 F0 AA 13
				39 00 00 40 00 00 13 C5 00 00 00 00 00 00 00 00 00 00 00 00 00 00 00 00 00 00
				39 00 00 40 00 00 05 63 10 00 00 00
				39 00 00 40 00 00 02 62 03
				39 00 00 00 00 00 03 F0 AA 00
			];
			mi,mdss-dsi-local-hbm-hlpm-white-110nit-command-update = <0xC5 2 18>, <0x63 3 4>;
			mi,mdss-dsi-local-hbm-hlpm-white-110nit-command-state = "dsi_hs_mode";

			mi,mdss-dsi-local-hbm-normal-green-500nit-command = [
				39 00 00 40 00 00 03 F0 AA 13
				39 00 00 40 00 00 13 C5 00 00 00 00 00 00 00 00 00 00 00 00 00 00 00 00 00 00
				39 00 00 40 00 00 05 63 10 00 00 00
				39 00 00 40 00 00 02 62 03
				39 00 00 00 00 00 03 F0 AA 00
			];
			mi,mdss-dsi-local-hbm-normal-green-500nit-command-update = <0xC5 1 18>, <0x63 2 4>;
			mi,mdss-dsi-local-hbm-normal-green-500nit-command-state = "dsi_hs_mode";

			mi,mdss-dsi-local-hbm-off-to-normal-command = [
				39 00 00 00 00 00 02 62 00
			];
			mi,mdss-dsi-local-hbm-off-to-normal-command-state = "dsi_hs_mode";
			mi,mdss-dsi-local-hbm-off-to-hbm-command = [
				39 00 00 00 00 00 02 62 00
			];
			mi,mdss-dsi-local-hbm-off-to-hbm-command-state = "dsi_hs_mode";
		};
	};
};


&mdss_mdp {
	dsi_o16u_36_0d_0b_P11_dsc_vid: qcom,mdss_dsi_o16u_36_0d_0b_P11_dsc_vid {
		qcom,mdss-dsi-panel-name = "xiaomi o16u 36 0d 0b video mode dsc dsi panel";
		qcom,mdss-dsi-panel-type = "dsi_video_mode";
		qcom,mdss-dsi-virtual-channel-id = <0>;
		qcom,mdss-dsi-stream = <0>;
		qcom,mdss-dsi-bpp = <30>;
		qcom,mdss-dsi-color-order = "rgb_swap_rgb";
		qcom,mdss-dsi-underflow-color = <0xff>;
		qcom,mdss-dsi-border-color = <0>;
		qcom,dsi-ctrl-num = <0>;
		qcom,dsi-phy-num = <0>;
		qcom,mdss-dsi-traffic-mode = "burst_mode";
		qcom,mdss-dsi-lane-map = "lane_map_0123";
		qcom,mdss-dsi-bllp-eof-power-mode;
		qcom,mdss-dsi-bllp-power-mode;
		qcom,mdss-dsi-lane-0-state;
		qcom,mdss-dsi-lane-1-state;
		qcom,mdss-dsi-lane-2-state;
		qcom,mdss-dsi-lane-3-state;
		qcom,mdss-dsi-dma-trigger = "trigger_sw";
		qcom,mdss-dsi-mdp-trigger = "none";
		qcom,mdss-dsi-reset-sequence =<1 20>, <0 5>, <1 20>;
		qcom,mdss-pan-physical-width-dimension = <695>;
		qcom,mdss-pan-physical-height-dimension = <1545>;
		qcom,mdss-dsi-tx-eot-append;
		qcom,mdss-dsi-lp11-init;
		qcom,mdss-dsi-bl-inverted-dbv;
		qcom,bl-update-flag = "delay_until_first_frame";
		qcom,mdss-dsi-panel-hdr-enabled;
		qcom,mdss-dsi-panel-hdr-color-primaries = <14500 15500 32000
			17000 15500 30000 8000 3000>;
		qcom,mdss-dsi-panel-peak-brightness = <10000000>;
		qcom,mdss-dsi-panel-blackness-level = <220>;

		mi,mdss-dsi-panel-wp-read-command = [06 01 00 01 00 00 01 A1];
		mi,mdss-dsi-panel-wp-read-command-state = "dsi_hs_mode";
		mi,mdss-dsi-panel-wp-read-length = <3>;

		mi,flatmode-status-check-enabled;
		mi,mdss-dsi-panel-flatmode-status-offset-command = [
			39 00 00 00 00 00 03 F0 AA 11
		];
		mi,mdss-dsi-panel-flatmode-status-offset-command-state = "dsi_hs_mode";
		mi,mdss-dsi-panel-flatmode-status-command = [
			06 01 00 01 00 00 01 D5
		];
		mi,mdss-dsi-panel-flatmode-status-command-state = "dsi_hs_mode";
		mi,mdss-dsi-panel-flatmode-status-offset-end-command = [
			39 00 00 00 00 00 03 F0 AA 00
		];
		mi,mdss-dsi-panel-flatmode-status-offset-end-command-state = "dsi_hs_mode";
		mi,mdss-dsi-panel-flatmode-status-read-length = <1>;
		mi,mdss-dsi-panel-flatmode-on-status-value = <0x13>;

		qcom,mdss-dsi-pan-enable-dynamic-fps;
		qcom,mdss-dsi-pan-fps-update =
		 	"dfps_immediate_porch_mode_vfp";
		qcom,dsi-supported-dfps-list = <120 90 60 30>;
		qcom,mdss-dsi-display-timings {
			timing@0{
				qcom,mdss-dsi-video-mode;
				qcom,mdss-dsi-panel-framerate = <120>;
				qcom,mdss-dsi-panel-width = <1220>;
				qcom,mdss-dsi-panel-height = <2712>;
				qcom,mdss-dsi-h-front-porch = <74>;
				qcom,mdss-dsi-h-back-porch = <16>;
				qcom,mdss-dsi-h-pulse-width = <16>;
				qcom,mdss-dsi-h-sync-skew = <0>;
				qcom,mdss-dsi-v-back-porch = <44>;
				qcom,mdss-dsi-v-front-porch = <56>;
				qcom,mdss-dsi-v-pulse-width = <4>;
				qcom,mdss-dsi-h-sync-pulse = <0>;
				qcom,mdss-dsi-h-left-border = <0>;
				qcom,mdss-dsi-h-right-border = <0>;
				qcom,mdss-dsi-v-top-border = <0>;
				qcom,mdss-dsi-v-bottom-border = <0>;
				qcom,mdss-dsi-panel-clockrate = <1096690000>;
				qcom,mdss-dsi-on-command = [
					/*compression mode*/
					39 00 00 40 00 00 02 03 01
					39 00 00 40 00 00 02 35 00
					39 00 00 40 00 00 02 53 20
					39 00 00 40 00 00 03 51 00 00
					/*DEMURA ON*/
					39 00 00 40 00 00 02 59 09
					39 00 00 40 00 00 02 5D 00
					39 00 00 40 00 00 02 6F 01
					39 00 00 00 00 00 02 6C 02
					/*PMIC PULSE fixed the AOD flash*/
					39 00 00 40 00 00 03 F0 AA 10
					39 00 00 00 00 00 1B D0 84 24 90 14 C0 00 2F 4B 11 4F 00 00 4B 2C 4F 00 00 00 04 44 11 11 11 00 00 00
					/*Active High Error Low*/
					39 00 00 40 00 00 03 F0 AA 10
					39 00 00 40 00 00 02 65 01
					39 00 00 40 00 00 02 CF 87
					39 00 00 40 00 00 02 65 08
					39 00 00 00 00 00 02 CF 0F
					/*video trim*/
					39 00 00 40 00 00 03 F0 AA 12
					39 00 00 40 00 00 04 C3 E1 20 50
					39 00 00 40 00 00 02 65 11
					39 00 00 40 00 00 0F C3 00 63 00 63 00 63 00 63 00 63 00 63 00 63
					39 00 00 40 00 00 11 CC 2A D7 2A D7 2A D7 2A D7 2A D7 2A D7 2A D7 04 BF
					39 00 00 40 00 00 03 FF 5A 80
					39 00 00 40 00 00 02 65 0A
					39 00 00 40 00 00 02 F9 A8
					39 00 00 40 00 00 03 F0 AA 10
					39 00 00 40 00 00 08 B0 05 4C 01 31 01 04 C4
					39 00 00 40 00 00 02 65 02
					39 00 00 40 00 00 04 D0 90 14 C0
					39 00 00 40 00 00 04 B8 32 00 0D
					39 00 00 40 00 00 04 B9 01 38 00
					39 00 00 40 00 00 03 F0 AA 11
					39 00 00 40 00 00 02 65 02
					39 00 00 40 00 00 03 D5 66 66
					39 00 00 40 00 00 02 D5 13
					39 00 00 40 00 00 03 F0 AA 12
					39 00 00 40 00 00 02 65 02
					39 00 00 40 00 00 02 D1 00
					//NO SYNC ELVSS
					39 00 00 40 00 00 02 65 01
					39 00 00 00 00 00 02 BE 05
					//OFF THE SWIRE PULSE
					39 00 00 40 00 00 03 F0 AA 10
					39 00 00 40 00 00 02 D0 84
					39 00 00 40 00 00 03 FF 5A 81
					39 00 00 40 00 00 02 65 02
					39 00 00 40 00 00 02 F4 27
					39 00 00 40 00 00 02 65 19
					39 00 00 40 00 00 02 F8 01
					39 00 00 40 00 00 02 65 03
					39 00 00 40 00 00 04 FB F3 F3 F3
					39 00 00 40 00 00 03 F0 AA 12
					39 00 00 00 00 00 02 DF 41
					/*Delay 120ms*/
					39 00 00 00 78 00 02 11 00
					39 00 00 40 00 00 03 F0 AA 12
					39 00 00 00 00 00 02 DF 11
					39 00 00 40 00 00 03 F0 AA 00
					39 00 00 00 00 00 03 FF 5A 00
					/* Display On */
					39 00 00 00 00 00 02 29 00
				];
				qcom,mdss-dsi-off-command = [
					05 00 00 00 0A 00 02 28 00
					05 00 00 00 78 00 02 10 00
				];
				qcom,mdss-dsi-on-command-state = "dsi_lp_mode";
				qcom,mdss-dsi-off-command-state = "dsi_lp_mode";
				qcom,compression-mode = "dsc";
				qcom,mdss-dsc-version = <0x12>;
				qcom,mdss-dsc-scr-version = <0x0>;
				qcom,mdss-dsc-slice-height = <12>;
				qcom,mdss-dsc-slice-width = <610>;
				qcom,mdss-dsc-slice-per-pkt = <2>;
				qcom,mdss-dsc-bit-per-component = <10>;
				qcom,mdss-dsc-bit-per-pixel = <8>;
				qcom,mdss-dsc-block-prediction-enable;
			};
		};
	};
};
&dsi_o16u_36_0d_0b_P11_dsc_vid {
	mi,panel-id = <0x4F313655 0x00360D0B>;
	mi,max-brightness-clone = <20479>;
	mi,normal-max-brightness-clone = <4095>;
	mi,mdss-dsi-fac-bl-max-level = <2047>;
	mi,mdss-fac-brightness-max-level = <2047>;
	mi,thermal-dimming-flag;
	mi,panel-on-dimming-delay = <120>;
	//qcom,mdss-dsi-panel-dimming-enabled;
	mi,flatmode-default-on-enabled;
	mi,ddic-round-corner-enabled;
	mi,local-hbm-enabled;
	mi,need-fod-animal-in-normal-enabled;
	mi,local-hbm-ui-ready-delay-num-frame = <3>; /* 1 frame */
	/* IRQF_ONESHOT | IRQF_TRIGGER_LOW */
	mi,esd-err-irq-gpio = <&tlmm 149 0x2008>;
	mi,panel-ignore-esd-in-aod;
	/* AOD CONFIG*/
	mi,doze-hbm-dbv-level = <245>;
	mi,doze-lbm-dbv-level = <20>;
	qcom,mdss-dsi-display-timings {
		timing@0{
			/*flat mode*/
			mi,mdss-dsi-flat-mode-on-command = [
				39 00 00 40 00 00 03 F0 AA 11
				39 00 00 40 00 00 02 D5 13
				39 00 00 00 00 00 03 F0 AA 00
			];
			mi,mdss-dsi-flat-mode-on-command-state = "dsi_hs_mode";

			mi,mdss-dsi-flat-mode-off-command = [
				39 00 00 40 00 00 03 F0 AA 11
				39 00 00 40 00 00 02 D5 12
				39 00 00 00 00 00 03 F0 AA 00
			];
			mi,mdss-dsi-flat-mode-off-command-state = "dsi_hs_mode";
			/* FPS Switch Setting */
			mi,mdss-dsi-fps-120-gamma-command = [
				39 00 00 00 00 00 02 6C 02
			];
			mi,mdss-dsi-fps-120-gamma-command-state = "dsi_hs_mode";
			mi,mdss-dsi-fps-90-gamma-command = [
				39 00 00 00 00 00 02 6C 01
			];
			mi,mdss-dsi-fps-90-gamma-command-state = "dsi_hs_mode";
			mi,mdss-dsi-fps-60-gamma-command = [
				39 00 00 00 00 00 02 6C 00
			];
			mi,mdss-dsi-fps-60-gamma-command-state = "dsi_hs_mode";

			qcom,mdss-dsi-nolp-command = [
				39 00 00 00 00 00 03 51 00 00
			];
			qcom,mdss-dsi-nolp-command-update = <0x51 0 2>;
			qcom,mdss-dsi-nolp-command-state = "dsi_hs_mode";
			mi,mdss-dsi-aod-enter-command = [
				05 00 00 00 00 00 01 39
			];
			mi,mdss-dsi-aod-enter-command-state = "dsi_hs_mode";

			mi,mdss-dsi-doze-hbm-command = [
				39 00 00 40 00 00 03 51 00 FC
				15 00 00 00 00 00 02 6D 01
			];
			mi,mdss-dsi-doze-hbm-command-state = "dsi_hs_mode";

			mi,mdss-dsi-doze-lbm-command = [
				39 00 00 40 00 00 03 51 00 14
				15 00 00 00 00 00 02 6D 00
			];
			mi,mdss-dsi-doze-lbm-command-state = "dsi_hs_mode";

			mi,mdss-dsi-aod-exit-command = [
				05 00 00 00 00 00 01 38
			];
			mi,mdss-dsi-aod-exit-command-state = "dsi_hs_mode";

			mi,mdss-dsi-doze-hbm-nolp-command = [
				39 00 00 00 00 00 03 51 00 FC
			];
			mi,mdss-dsi-doze-hbm-nolp-command-state = "dsi_hs_mode";

			mi,mdss-dsi-doze-lbm-nolp-command = [
				39 00 00 00 00 00 03 51 00 14
			];
			mi,mdss-dsi-doze-lbm-nolp-command-state = "dsi_hs_mode";
			//rounc corner
			mi,mdss-dsi-round-corner-on-command = [
				39 00 00 40 00 00 03 F0 AA 18
				15 00 00 40 00 00 02 B0 19
				39 00 00 00 00 00 03 F0 AA 00
			];
			mi,mdss-dsi-round-corner-on-command-state = "dsi_lp_mode";
			mi,mdss-dsi-round-corner-off-command = [
				39 00 00 40 00 00 03 F0 AA 18
				15 00 00 40 00 00 02 B0 00
				39 00 00 00 00 00 03 F0 AA 00
			];
			mi,mdss-dsi-round-corner-off-command-state = "dsi_lp_mode";
			//lhbm
			mi,mdss-dsi-local-hbm-normal-white-1000nit-command = [
				39 00 00 00 00 00 03 51 07 FF
				39 00 00 40 00 00 03 F0 AA 13
				39 00 00 40 00 00 13 C5 00 00 00 00 00 00 00 00 00 00 00 00 00 00 00 00 00 00
				39 00 00 40 00 00 05 63 10 00 00 00
				39 00 00 40 00 00 02 62 03
				39 00 00 00 00 00 03 F0 AA 00
			];
			mi,mdss-dsi-local-hbm-normal-white-1000nit-command-update = <0x51 0 2>, <0xC5 2 18>, <0x63 3 4>;
			mi,mdss-dsi-local-hbm-normal-white-1000nit-command-state = "dsi_hs_mode";
			mi,mdss-dsi-local-hbm-hlpm-white-1000nit-command = [
				/* nolp */
				05 00 00 00 00 00 01 38
				/* lhbm setting */
				39 00 00 40 00 00 03 F0 AA 13
				39 00 00 40 00 00 13 C5 00 00 00 00 00 00 00 00 00 00 00 00 00 00 00 00 00 00
				39 00 00 40 00 00 05 63 10 00 00 00
				39 00 00 40 00 00 02 62 03
				39 00 00 00 00 00 03 F0 AA 00
			];
			mi,mdss-dsi-local-hbm-hlpm-white-1000nit-command-update = <0xC5 2 18>, <0x63 3 4>;
			mi,mdss-dsi-local-hbm-hlpm-white-1000nit-command-state = "dsi_hs_mode";

			mi,mdss-dsi-local-hbm-normal-white-110nit-command = [
				39 00 00 40 00 00 03 F0 AA 13
				39 00 00 40 00 00 13 C5 00 00 00 00 00 00 00 00 00 00 00 00 00 00 00 00 00 00
				39 00 00 40 00 00 05 63 10 00 00 00
				39 00 00 40 00 00 02 62 03
				39 00 00 00 00 00 03 F0 AA 00
			];
			mi,mdss-dsi-local-hbm-normal-white-110nit-command-update = <0xC5 1 18>, <0x63 2 4>;
			mi,mdss-dsi-local-hbm-normal-white-110nit-command-state = "dsi_hs_mode";
			mi,mdss-dsi-local-hbm-hlpm-white-110nit-command = [
				/* nolp */
				05 00 00 00 00 00 01 38
				/* lhbm setting */
				39 00 00 40 00 00 03 F0 AA 13
				39 00 00 40 00 00 13 C5 00 00 00 00 00 00 00 00 00 00 00 00 00 00 00 00 00 00
				39 00 00 40 00 00 05 63 10 00 00 00
				39 00 00 40 00 00 02 62 03
				39 00 00 00 00 00 03 F0 AA 00
			];
			mi,mdss-dsi-local-hbm-hlpm-white-110nit-command-update = <0xC5 2 18>, <0x63 3 4>;
			mi,mdss-dsi-local-hbm-hlpm-white-110nit-command-state = "dsi_hs_mode";

			mi,mdss-dsi-local-hbm-normal-green-500nit-command = [
				39 00 00 40 00 00 03 F0 AA 13
				39 00 00 40 00 00 13 C5 00 00 00 00 00 00 00 00 00 00 00 00 00 00 00 00 00 00
				39 00 00 40 00 00 05 63 10 00 00 00
				39 00 00 40 00 00 02 62 03
				39 00 00 00 00 00 03 F0 AA 00
			];
			mi,mdss-dsi-local-hbm-normal-green-500nit-command-update = <0xC5 1 18>, <0x63 2 4>;
			mi,mdss-dsi-local-hbm-normal-green-500nit-command-state = "dsi_hs_mode";

			mi,mdss-dsi-local-hbm-off-to-normal-command = [
				39 00 00 00 00 00 02 62 00
			];
			mi,mdss-dsi-local-hbm-off-to-normal-command-state = "dsi_hs_mode";
			mi,mdss-dsi-local-hbm-off-to-hbm-command = [
				39 00 00 00 00 00 02 62 00
			];
			mi,mdss-dsi-local-hbm-off-to-hbm-command-state = "dsi_hs_mode";
		};
	};
};

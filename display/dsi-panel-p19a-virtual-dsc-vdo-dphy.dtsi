
&mdss_mdp {
	dsi_p19a_virtual_video_dphy: qcom,mdss_dsi_p19a_virtual_video_dphy {
		qcom,mdss-dsi-panel-name =
			"p19a virtual display";
		qcom,mdss-dsi-panel-type = "dsi_video_mode";
		qcom,mdss-dsi-panel-physical-type = "oled";
		qcom,dsi-ctrl-num = <0>;
		qcom,dsi-phy-num = <0>;
		qcom,mdss-dsi-virtual-channel-id = <0>;
		qcom,mdss-dsi-stream = <0>;
		qcom,mdss-dsi-bpp = <24>;
		qcom,mdss-dsi-border-color = <0>;
		qcom,mdss-dsi-traffic-mode = "burst_mode";
		qcom,mdss-dsi-bllp-eof-power-mode;
		qcom,mdss-dsi-bllp-power-mode;
		//qcom,mdss-dsi-lp11-init;
		qcom,mdss-dsi-lane-0-state;
		qcom,mdss-dsi-lane-1-state;
		qcom,mdss-dsi-lane-2-state;
		qcom,mdss-dsi-lane-3-state;
		qcom,mdss-dsi-dma-trigger = "trigger_sw";
		qcom,mdss-dsi-mdp-trigger = "none";
		qcom,mdss-dsi-reset-sequence = <0 1>, <1 10>;
		qcom,mdss-dsi-dma-schedule-line = <3>;
		//qcom,mdss-dsi-tx-eot-append;
		qcom,mdss-pan-physical-width-dimension = <70>;
		qcom,mdss-pan-physical-height-dimension = <156>;


		//qcom,mdss-dsi-pan-enable-dynamic-fps;
		//qcom,mdss-dsi-pan-fps-update = "dfps_immediate_porch_mode_vfp";
		//qcom,dsi-supported-dfps-list = <120 90 60 30>;
		//mi,video-mode-multi-timing;

		qcom,mdss-dsi-display-timings {
			timing@0 {
				cell-index = <0>;
				qcom,mdss-dsi-panel-framerate = <120>;
				qcom,mdss-dsi-panel-width = <1080>;
				qcom,mdss-dsi-panel-height = <2396>;
				qcom,mdss-dsi-h-front-porch = <112>;
				qcom,mdss-dsi-h-back-porch = <80>;
				qcom,mdss-dsi-h-pulse-width = <32>;
				qcom,mdss-dsi-h-sync-skew = <0>;
				qcom,mdss-dsi-v-back-porch = <24>;
				qcom,mdss-dsi-v-front-porch = <10>;
				qcom,mdss-dsi-v-pulse-width = <2>;
				qcom,mdss-dsi-h-left-border = <0>;
				qcom,mdss-dsi-h-right-border = <0>;
				qcom,mdss-dsi-v-top-border = <0>;
				qcom,mdss-dsi-v-bottom-border = <0>;
				qcom,mdss-dsi-on-command = [
					05 01 00 00 64 00 01 11
					05 01 00 00 00 00 01 29
				];
				qcom,mdss-dsi-off-command = [
					05 01 00 00 14 00 02 28 00
					05 01 00 00 78 00 02 10 00
				];
				qcom,mdss-dsi-on-command-state = "dsi_lp_mode";
 				qcom,mdss-dsi-pre-off-command-state = "dsi_hs_mode";
				//qcom,mdss-dsi-h-sync-pulse = <0>;
				qcom,compression-mode = "dsc";
				qcom,mdss-dsc-version = <0x11>;
				qcom,mdss-dsc-scr-version = <0x0>;
				qcom,mdss-dsc-slice-height = <599>;
				qcom,mdss-dsc-slice-width = <540>;
				qcom,mdss-dsc-slice-per-pkt = <2>;
				qcom,mdss-dsc-bit-per-component = <8>;
				qcom,mdss-dsc-bit-per-pixel = <8>;
				qcom,mdss-dsc-block-prediction-enable;
				qcom,mdss-dsi-dispparam-120hz-command = [
					//39 01 00 40 00 00 0B 9F 5A 5A 00 00 00 00 00 00 00 00
					39 01 00 40 00 00 0B F0 5A 5A 00 00 00 00 00 00 00 00
					15 01 00 40 00 00 02 60 00
					39 01 00 40 00 00 04 B0 00 2A C9
					39 01 00 40 00 00 05 C9 00 0A 00 0A
					39 01 00 40 00 00 04 B0 01 35 66
					39 01 00 40 00 00 21 66 09 80 09 50 09 10 08 A0 08 38 07 C8 06 F0 06 18 05 38 04 60 03 88 02 B0 01 00 00 20 00 20 00 20
					39 01 00 40 00 00 04 B0 01 61 66
					39 01 00 40 00 00 21 66 09 80 09 50 09 10 08 A0 08 38 07 C8 06 F0 06 18 05 38 04 60 03 88 02 B0 01 00 00 20 00 20 00 20
					15 01 00 40 00 00 02 F7 0F
					39 01 00 40 00 00 0B F0 A5 A5 00 00 00 00 00 00 00 00
					//39 01 00 00 00 00 0B 9F A5 A5 00 00 00 00 00 00 00 00
				];
				qcom,mdss-dsi-dispparam-90hz-command = [
					//39 01 00 40 00 00 0B 9F 5A 5A 00 00 00 00 00 00 00 00
					39 01 00 40 00 00 0B F0 5A 5A 00 00 00 00 00 00 00 00
					15 01 00 40 00 00 02 60 00
					39 01 00 40 00 00 04 B0 00 2A C9
					39 01 00 40 00 00 05 C9 03 2A 03 2A
					39 01 00 40 00 00 04 B0 01 35 66
					39 01 00 40 00 00 21 66 0C A0 0C 60 0C 0A 0B 78 0A EC 0A 58 09 38 08 10 06 F0 05 D0 04 B2 03 8A 01 58 00 2B 00 2B 00 2B
					39 01 00 40 00 00 04 B0 01 61 66
					39 01 00 40 00 00 21 66 0C A0 0C 60 0C 0A 0B 78 0A EC 0A 58 09 38 08 10 06 F0 05 D0 04 B2 03 8A 01 58 00 2B 00 2B 00 2B
					15 01 00 40 00 00 02 F7 0F
					39 01 00 40 00 00 0B F0 A5 A5 00 00 00 00 00 00 00 00
					//39 01 00 00 00 00 0B 9F A5 A5 00 00 00 00 00 00 00 00
				];
				qcom,mdss-dsi-dispparam-60hz-command = [
					//39 01 00 40 00 00 0B 9F 5A 5A 00 00 00 00 00 00 00 00
					39 01 00 40 00 00 0B F0 5A 5A 00 00 00 00 00 00 00 00
					15 01 00 40 00 00 02 60 01
					39 01 00 40 00 00 04 B0 00 2A C9
					39 01 00 40 00 00 05 C9 00 0A 00 0A
					39 01 00 40 00 00 04 B0 01 35 66
					39 01 00 40 00 00 21 66 09 80 09 50 09 10 08 A0 08 38 07 C8 06 F0 06 18 05 38 04 60 03 88 02 B0 01 00 00 20 00 20 00 20
					39 01 00 40 00 00 04 B0 01 61 66
					39 01 00 40 00 00 21 66 09 80 09 50 09 10 08 A0 08 38 07 C8 06 F0 06 18 05 38 04 60 03 88 02 B0 01 00 00 20 00 20 00 20
					15 01 00 40 00 00 02 F7 0F
					39 01 00 40 00 00 0B F0 A5 A5 00 00 00 00 00 00 00 00
					//39 01 00 00 00 00 0B 9F A5 A5 00 00 00 00 00 00 00 00
				];
				qcom,mdss-dsi-dispparam-30hz-command = [
					//39 01 00 40 00 00 0B 9F 5A 5A 00 00 00 00 00 00 00 00
					39 01 00 40 00 00 0B F0 5A 5A 00 00 00 00 00 00 00 00
					15 01 00 40 00 00 02 60 01
					39 01 00 40 00 00 04 B0 00 2A C9
					39 01 00 40 00 00 05 C9 00 0A 00 0A
					39 01 00 40 00 00 04 B0 01 35 66
					39 01 00 40 00 00 21 66 09 80 09 50 09 10 08 A0 08 38 07 C8 06 F0 06 18 05 38 04 60 03 88 02 B0 01 00 00 20 00 20 00 20
					39 01 00 40 00 00 04 B0 01 61 66
					39 01 00 40 00 00 21 66 09 80 09 50 09 10 08 A0 08 38 07 C8 06 F0 06 18 05 38 04 60 03 88 02 B0 01 00 00 20 00 20 00 20
					15 01 00 40 00 00 02 F7 0F
					39 01 00 40 00 00 0B F0 A5 A5 00 00 00 00 00 00 00 00
					//39 01 00 00 00 00 0B 9F A5 A5 00 00 00 00 00 00 00 00
				];
				qcom,mdss-dsi-dispparam-120hz-command-state = "dsi_lp_mode";
				qcom,mdss-dsi-dispparam-90hz-command-state = "dsi_lp_mode";
				qcom,mdss-dsi-dispparam-60hz-command-state = "dsi_lp_mode";
				qcom,mdss-dsi-dispparam-30hz-command-state = "dsi_lp_mode";
			};
		};
	};
};

&dsi_p19a_virtual_video_dphy{
	qcom,panel-supply-entries = <&dsi_panel_pwr_supply_no_labibb>;
    qcom,mdss-dsi-bl-pmic-control-type = "bl_ctrl_dcs";
    qcom,mdss-dsi-bl-min-level = <5>;
    qcom,mdss-dsi-bl-max-level = <4095>;
    qcom,mdss-brightness-max-level = <4095>;
    qcom,mdss-dsi-bl-inverted-dbv;
    qcom,bl-dsc-cmd-state = "dsi_lp_mode";
    qcom,platform-reset-gpio = <&tlmm 66 0>;
    qcom,platform-dvdd-gpio = <&tlmm 26 0>;
    qcom,platform-vci-gpio = <&tlmm 65 0>;

    qcom,dsi-select-clocks = "pll_byte_clk0", "pll_dsi_clk0";



    qcom,mdss-dsi-display-timings {
            timing@0 {
                    qcom,mdss-dsi-panel-phy-timings = [00 22 09 09 19 17 09
                                    09 09 02 04 00 1D 0E];
                    qcom,display-topology = <1 1 1>;
                    qcom,default-topology-index = <0>;
            };
    };
};


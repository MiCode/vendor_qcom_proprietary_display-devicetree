/dts-v1/;
/plugin/;

#include "khaje-sde-display-idp-nopmi.dtsi"

/ {
        model = "Qualcomm Technologies, Inc. KHAJE IDP nopmi xun";
        compatible = "qcom,khaje-idp", "qcom,khaje", "qcom,idp";
        qcom,msm-id = <518 0x10000>;
        qcom,board-id = <0x20022 0>;
        qcom,pmic-id = <0x2D 0x0 0x0 0x0>;
};

&qupv3_se1_i2c{
        status = "ok";
                bkl-bl@11 {
                        compatible = "bkl,bkl-bl";
                        reg = <0x11>;
                        pinctrl-names = "bkl_active","bkl_sleep";
                        pinctrl-0 = <&bkl_active>;
                        pinctrl-1 = <&bkl_sleep>;
                        bkl,hwen-gpio = <&tlmm 102 0>;
                };
};

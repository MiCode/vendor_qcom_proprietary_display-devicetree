/dts-v1/;
/plugin/;

#include "khaje-sde-display-idp.dtsi"

/ {
	model = "Qualcomm Technologies, Inc. Khaje IDP";
        compatible = "qcom,khaje-idp", "qcom,khaje", "qcom,idp";
        qcom,msm-id = <518 0x10000>;
        qcom,board-id = <0x10022 0>;
        qcom,pmic-id = <0x2D 0x2E 0x0 0x0>;
};

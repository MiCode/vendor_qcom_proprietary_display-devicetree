&mdss_mdp {
	dsi_p17_dummy_amoled_dsc_vid: qcom,mdss_dsi_p17_dummy_amoled_dsc_vid {
	qcom,mdss-dsi-panel-name =
		"dsi p17 dummy amoled video mode dsi panel with DSC";
	qcom,mdss-dsi-panel-type = "dsi_video_mode";
	qcom,mdss-dsi-panel-physical-type = "oled";
	qcom,dsi-ctrl-num = <0>;
	qcom,dsi-phy-num = <0>;

	qcom,mdss-dsi-virtual-channel-id = <0>;
	qcom,mdss-dsi-stream = <0>;
	qcom,mdss-dsi-bpp = <30>;
	qcom,mdss-dsi-border-color = <0>;
	qcom,mdss-dsi-traffic-mode = "burst_mode";
	qcom,mdss-dsi-bllp-eof-power-mode;
	qcom,mdss-dsi-bllp-power-mode;
	qcom,mdss-dsi-lane-0-state;
	qcom,mdss-dsi-lane-1-state;
	qcom,mdss-dsi-lane-2-state;
	qcom,mdss-dsi-lane-3-state;
	qcom,mdss-dsi-dma-trigger = "trigger_sw";
	qcom,mdss-dsi-mdp-trigger = "none";
	qcom,mdss-pan-physical-width-dimension = <708>;
	qcom,mdss-pan-physical-height-dimension = <1568>;
	qcom,mdss-dsi-lp11-init;
	qcom,mdss-dsi-reset-sequence = <1 10>, <0 10>, <1 10>;
	qcom,adjust-timer-wakeup-ms = <1>;

	qcom,mdss-dsi-display-timings {
		timing@0 {
			qcom,mdss-dsi-panel-width = <1080>;
			qcom,mdss-dsi-panel-height = <2392>;
			qcom,mdss-dsi-h-front-porch = <96>;
			qcom,mdss-dsi-h-back-porch = <80>;
			qcom,mdss-dsi-h-pulse-width = <16>;
			qcom,mdss-dsi-h-sync-skew = <0>;
			qcom,mdss-dsi-v-back-porch = <26>;
			qcom,mdss-dsi-v-front-porch = <140>;
			qcom,mdss-dsi-v-pulse-width = <2>;
			qcom,mdss-dsi-h-left-border = <0>;
			qcom,mdss-dsi-panel-framerate = <120>;
			qcom,mdss-dsi-on-command = [
			  05 01 00 00 64 00 01 11
			  05 01 00 00 05 00 01 29];
			qcom,mdss-dsi-off-command = [
			  05 01 00 00 10 00 01 28
			  05 01 00 00 32 00 01 10];
			qcom,mdss-dsi-on-command-state = "dsi_lp_mode";
			qcom,mdss-dsi-off-command-state = "dsi_lp_mode";
			qcom,compression-mode = "dsc";
			qcom,mdss-dsc-version = <0x12>;
			qcom,mdss-dsc-scr-version = <0x0>;
			qcom,mdss-dsc-slice-height = <8>;
			qcom,mdss-dsc-slice-width = <540>;
			qcom,mdss-dsc-slice-per-pkt = <2>;
			qcom,mdss-dsc-bit-per-component = <10>;
			qcom,mdss-dsc-bit-per-pixel = <8>;
			qcom,mdss-dsc-block-prediction-enable;
			};
		};
	};
};

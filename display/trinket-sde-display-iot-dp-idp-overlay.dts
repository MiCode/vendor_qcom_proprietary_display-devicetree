/dts-v1/;
/plugin/;

#include "trinket-sde.dtsi"
#include "trinket-sde-display-iot-dp-idp.dtsi"

/ {
	model = "Qualcomm Technologies, Inc. TRINKET IOT DP IDP Overlay";
	compatible = "qcom,trinket-iot";
	qcom,msm-id = <467 0x10000>, <468 0x10000>;
	qcom,board-id = <34 4>;
};

&mdss_mdp {
	dsi_n83_42_02_0b_wqxga_video_cphy: qcom,mdss_dsi_n83_42_02_0b_wqxga_video_cphy {
		qcom,mdss-dsi-panel-name =
			"xiaomi n83 42 02 0b cphy nt36532 csot";
		qcom,mdss-dsi-panel-type = "dsi_video_mode";
		qcom,dsi-ctrl-num = <0>;
		qcom,dsi-phy-num = <0>;
		qcom,mdss-dsi-virtual-channel-id = <0>;
		qcom,mdss-dsi-stream = <0>;
		qcom,mdss-dsi-bpp = <30>;
		qcom,mdss-dsi-border-color = <0>;
		qcom,mdss-dsi-traffic-mode = "non_burst_sync_event";
		qcom,mdss-dsi-bllp-power-mode;
		qcom,mdss-dsi-bllp-eof-power-mode;
		qcom,mdss-dsi-lane-0-state;
		qcom,mdss-dsi-lane-1-state;
		qcom,mdss-dsi-lane-2-state;
		qcom,mdss-dsi-dma-trigger = "trigger_sw";
		qcom,mdss-dsi-mdp-trigger = "none";
		qcom,mdss-dsi-reset-sequence = <1 10>, <0 10>, <1 10>;
		qcom,mdss-dsi-tx-eot-append;
                qcom,mdss-dsi-rx-eot-ignore;
		qcom,adjust-timer-wakeup-ms = <1>;
		qcom,panel-cphy-mode;
                qcom,dispparam-enabled;
		qcom,mdss-dsi-panel-hdr-enabled;
		qcom,mdss-dsi-panel-hdr-color-primaries = <39000 16000 33750
						 39800 13250 34450 7500 3000>;
		qcom,mdss-dsi-panel-peak-brightness = <6450000>;
		qcom,mdss-dsi-panel-blackness-level = <4961>;
		qcom,mdss-pan-physical-width-dimension = <1629>;
		qcom,mdss-pan-physical-height-dimension = <2606>;
		qcom,mdss-dsi-pan-enable-dynamic-fps;
		qcom,mdss-dsi-pan-fps-update = "dfps_immediate_porch_mode_vfp";
		qcom,dsi-supported-dfps-list = <120 90 60 50 48 30>;
		qcom,mdss-dsi-display-timings {
			timing@0 {
				cell-index = <0>;
				qcom,mdss-dsi-panel-width = <1600>;
				qcom,mdss-dsi-panel-height = <2560>;
				qcom,mdss-dsi-h-front-porch = <30>;
				qcom,mdss-dsi-h-back-porch = <20>;
				qcom,mdss-dsi-h-pulse-width = <10>;
				qcom,mdss-dsi-h-sync-skew = <0>;
				qcom,mdss-dsi-v-back-porch = <170>;
				qcom,mdss-dsi-v-front-porch = <2784>;
				qcom,mdss-dsi-v-pulse-width = <2>;
				qcom,mdss-dsi-panel-framerate = <60>;
                                qcom,mdss-dsi-panel-clockrate = <688000000>;
				qcom,mdss-dsi-on-command = [
					39 01 00 00 00 00 02 FF 23
					39 01 00 00 00 00 02 FB 01
					39 01 00 00 00 00 02 00 80
					39 01 00 00 00 00 02 05 22
					39 01 00 00 00 00 02 06 02
					39 01 00 00 00 00 02 07 00
					39 01 00 00 00 00 02 08 01
					39 01 00 00 00 00 02 09 C2
					39 01 00 00 00 00 02 0A 1D
					39 01 00 00 00 00 02 0B 1D
					39 01 00 00 00 00 02 0C A8
					39 01 00 00 00 00 02 0D 05


					//Resolution Related
					39 01 00 00 00 00 02 10 00
					39 01 00 00 00 00 02 11 02
					39 01 00 00 00 00 02 12 80
					39 01 00 00 00 00 02 15 84
					39 01 00 00 00 00 02 16 15
					39 01 00 00 00 00 02 19 00
					39 01 00 00 00 00 02 1A 04
					39 01 00 00 00 00 02 1B 08
					39 01 00 00 00 00 02 1C 0C
					39 01 00 00 00 00 02 1D 10
					39 01 00 00 00 00 02 1E 14
					39 01 00 00 00 00 02 1F 18
					39 01 00 00 00 00 02 20 1C
					39 01 00 00 00 00 02 21 20
					39 01 00 00 00 00 02 22 24
					39 01 00 00 00 00 02 23 28
					39 01 00 00 00 00 02 24 2C
					39 01 00 00 00 00 02 25 30
					39 01 00 00 00 00 02 26 34
					39 01 00 00 00 00 02 27 38
					39 01 00 00 00 00 02 28 3C

					39 01 00 00 00 00 02 29 10
					39 01 00 00 00 00 02 2A 20
					39 01 00 00 00 00 02 2B 20

					//UI Mode
					39 01 00 00 00 00 02 30 FF
					39 01 00 00 00 00 02 31 FE
					39 01 00 00 00 00 02 32 FD
					39 01 00 00 00 00 02 33 FC
					39 01 00 00 00 00 02 34 FA
					39 01 00 00 00 00 02 35 F8
					39 01 00 00 00 00 02 36 F7
					39 01 00 00 00 00 02 37 F3
					39 01 00 00 00 00 02 38 F0
					39 01 00 00 00 00 02 39 EE
					39 01 00 00 00 00 02 3A EC
					39 01 00 00 00 00 02 3B EA
					39 01 00 00 00 00 02 3D E9
					39 01 00 00 00 00 02 3F E7
					39 01 00 00 00 00 02 40 E6
					39 01 00 00 00 00 02 41 E4
					//Still Mode
					39 01 00 00 00 00 02 45 FF
					39 01 00 00 00 00 02 46 FD
					39 01 00 00 00 00 02 47 FB
					39 01 00 00 00 00 02 48 F7
					39 01 00 00 00 00 02 49 F3
					39 01 00 00 00 00 02 4A EB
					39 01 00 00 00 00 02 4B E3
					39 01 00 00 00 00 02 4C DA
					39 01 00 00 00 00 02 4D D4
					39 01 00 00 00 00 02 4E CD
					39 01 00 00 00 00 02 4F C8
					39 01 00 00 00 00 02 50 BE
					39 01 00 00 00 00 02 51 B2
					39 01 00 00 00 00 02 52 AA
					39 01 00 00 00 00 02 53 65
					39 01 00 00 00 00 02 54 60
					//MOV Mode
					39 01 00 00 00 00 02 58 FF
					39 01 00 00 00 00 02 59 FD
					39 01 00 00 00 00 02 5A FC
					39 01 00 00 00 00 02 5B F9
					39 01 00 00 00 00 02 5C F6
					39 01 00 00 00 00 02 5D F2
					39 01 00 00 00 00 02 5E EB
					39 01 00 00 00 00 02 5F D7
					39 01 00 00 00 00 02 60 D2
					39 01 00 00 00 00 02 61 CD
					39 01 00 00 00 00 02 62 C9
					39 01 00 00 00 00 02 63 C6
					39 01 00 00 00 00 02 64 C2
					39 01 00 00 00 00 02 65 BE
					39 01 00 00 00 00 02 66 B2
					39 01 00 00 00 00 02 67 AF

					39 01 00 00 00 00 02 FF D0
					39 01 00 00 00 00 02 FB 01
					39 01 00 00 00 00 02 1C 77
					39 01 00 00 00 00 02 1D 07
					39 01 00 00 00 00 02 09 FF

					39 01 00 00 00 00 02 FF 2A
					39 01 00 00 00 00 02 FB 01
					39 01 00 00 00 00 02 F1 03

					39 01 00 00 00 00 02 FF 24
					39 01 00 00 00 00 02 FB 01
					39 01 00 00 00 00 02 33 03
					39 01 00 00 00 00 02 34 03
					39 01 00 00 00 00 02 51 34
					39 01 00 00 00 00 02 52 12
					39 01 00 00 00 00 02 53 78
					39 01 00 00 00 00 02 54 56
					39 01 00 00 00 00 03 55 02 02
					39 01 00 00 00 00 02 9D 3E

					39 01 00 00 00 00 02 FF 26
                                        39 01 00 00 00 00 02 FB 01
                                        39 01 00 00 00 00 02 16 10
                                        39 01 00 00 00 00 02 1D 00
                                        39 01 00 00 00 00 02 39 06
                                        39 01 00 00 00 00 02 49 06
                                        39 01 00 00 00 00 02 A7 04
					39 01 00 00 00 00 02 C9 00
					39 01 00 00 00 00 02 CB 00
                                        39 01 00 00 00 00 03 CD 50 58
                                        39 01 00 00 00 00 03 CE 4D 58

					39 01 00 00 00 00 02 FF 27
					39 01 00 00 00 00 02 FB 01
					39 01 00 00 00 00 02 D0 31
                                        39 01 00 00 00 00 02 D1 28
                                        39 01 00 00 00 00 02 D2 30
                                        39 01 00 00 00 00 02 D4 00
                                        39 01 00 00 00 00 02 DE 43
                                        39 01 00 00 00 00 02 DF 02

					39 01 00 00 00 00 02 FF 10
					39 01 00 00 00 00 02 FB 01
					39 01 00 00 00 00 07 3B 03 AC 1A 04 04 00
					39 01 00 00 00 00 02 90 13
					39 01 00 00 00 00 11 91 AB A8 00 14 D2 00 00 00 02 2B 00 0B 05 7A 03 68
					39 01 00 00 00 00 03 92 10 E0
					39 01 00 00 00 00 02 9D 01
					39 01 00 00 00 00 02 B2 91
					39 01 00 00 00 00 02 B3 00
					39 01 00 00 00 00 03 51 0F FF
					39 01 00 00 00 00 02 53 2C

					15 01 00 00 78 00 02 11 00
					15 01 00 00 00 00 02 29 00
				];
				qcom,mdss-dsi-on-command-state = "dsi_lp_mode";
				qcom,mdss-dsi-off-command = [
					05 01 00 00 10 00 01 28
					05 01 00 00 32 00 01 10
				];
				qcom,mdss-dsi-off-command-state = "dsi_lp_mode";
				qcom,mdss-dsi-dispparam-pen-120hz-command = [
					39 00 00 40 00 00 02 FF 10
					39 00 00 40 00 00 02 B2 91
					39 00 00 00 00 00 02 B3 00];
				qcom,mdss-dsi-dispparam-pen-90hz-command = [
					39 00 00 40 00 00 02 FF 10
					39 00 00 40 00 00 02 B2 00
					39 00 00 00 00 00 02 B3 40];
				qcom,mdss-dsi-dispparam-pen-60hz-command = [
					39 00 00 40 00 00 02 FF 10
					39 00 00 40 00 00 02 B2 91
					39 00 00 00 00 00 02 B3 00];
				qcom,mdss-dsi-dispparam-pen-50hz-command = [
					39 00 00 40 00 00 02 FF 10
					39 00 00 40 00 00 02 B2 00
					39 00 00 00 00 00 02 B3 40];
				qcom,mdss-dsi-dispparam-pen-48hz-command = [
					39 00 00 40 00 00 02 FF 10
					39 00 00 40 00 00 02 B2 00
					39 00 00 00 00 00 02 B3 40];
				qcom,mdss-dsi-dispparam-pen-30hz-command = [
					39 00 00 40 00 00 02 FF 10
					39 00 00 40 00 00 02 B2 00
					39 00 00 00 00 00 02 B3 40];
				mi,mdss-dsi-dispparam-pen-clear-command = [
                        39 00 00 40 00 00 02 FF 10
                        39 00 00 40 00 00 02 FB 01
                        39 00 00 00 00 00 02 B2 80
			    ];
                qcom,mdss-dsi-dispparam-cabc-ui-on-command = [
					39 01 00 00 00 00 02 55 01
				];
				qcom,mdss-dsi-dispparam-cabc-still-on-command = [
					39 01 00 00 00 00 02 55 02
				];
				qcom,mdss-dsi-dispparam-cabc-movice-on-command = [
					39 01 00 00 00 00 02 55 03
				];
				qcom,mdss-dsi-dispparam-cabc-off-command = [
					39 01 00 00 00 00 02 55 00
				];
                                qcom,mdss-dsi-screen-off-command = [
                                	39 01 00 00 00 00 02 FF 27
					39 01 00 00 00 00 02 D0 00
                                        39 01 00 00 00 00 02 FF 10
                                        05 01 00 00 10 00 01 28
					05 01 00 00 32 00 01 10
				];
                                qcom,mdss-dsi-screen-off-command-state = "dsi_lp_mode";
				qcom,mdss-dsi-dispparam-pen-120hz-command-state = "dsi_lp_mode";
				qcom,mdss-dsi-dispparam-pen-90hz-command-state = "dsi_lp_mode";
				qcom,mdss-dsi-dispparam-pen-60hz-command-state = "dsi_lp_mode";
				qcom,mdss-dsi-dispparam-pen-50hz-command-state = "dsi_lp_mode";
				qcom,mdss-dsi-dispparam-pen-48hz-command-state = "dsi_lp_mode";
				qcom,mdss-dsi-dispparam-pen-30hz-command-state = "dsi_lp_mode";
				mi,mdss-dsi-dispparam-pen-clear-command-state = "dsi_lp_mode";
                qcom,mdss-dsi-dispparam-cabc-ui-on-command-status = "dsi_lp_mode";
				qcom,mdss-dsi-dispparam-cabc-still-on-command-status = "dsi_lp_mode";
				qcom,mdss-dsi-dispparam-cabc-movice-on-command-status = "dsi_lp_mode";
				qcom,mdss-dsi-dispparam-cabc-off-command-status = "dsi_lp_mode";
                qcom,compression-mode = "dsc";
				qcom,mdss-dsc-version = <0x12>;
				qcom,mdss-dsc-scr-version = <0x0>;
				qcom,mdss-dsc-slice-height = <20>;
				qcom,mdss-dsc-slice-width = <800>;
				qcom,mdss-dsc-slice-per-pkt = <2>;
				qcom,mdss-dsc-bit-per-component = <10>;
				qcom,mdss-dsc-bit-per-pixel = <8>;
				qcom,mdss-dsc-block-prediction-enable;
			};
		};
	};
};

&mdss_mdp {
	dsi_panel_m84_36_02_0a_fhdp_video: qcom,mdss_dsi_panel_m84_36_02_0a_fhdp_video {
		qcom,mdss-dsi-panel-name =
			"m84 36 02 0a video mode fhdp dsi panel";
		qcom,mdss-dsi-panel-type = "dsi_video_mode";
		qcom,dsi-ctrl-num = <0>;
		qcom,dsi-phy-num = <0>;
		qcom,mdss-dsi-virtual-channel-id = <0>;
		qcom,mdss-dsi-stream = <0>;

		qcom,mdss-dsi-h-left-border = <0>;
		qcom,mdss-dsi-h-right-border = <0>;
		qcom,mdss-dsi-v-top-border = <0>;
		qcom,mdss-dsi-v-bottom-border = <0>;
		qcom,mdss-dsi-bpp = <24>;
		qcom,mdss-dsi-color-order = "rgb_swap_rgb";
		qcom,mdss-dsi-underflow-color = <0xff>;

		qcom,mdss-dsi-border-color = <0>;
		qcom,mdss-dsi-h-sync-pulse = <0>;
		qcom,mdss-dsi-traffic-mode = "non_burst_sync_event";
		qcom,mdss-dsi-lane-map = "lane_map_0123";
		qcom,mdss-dsi-bllp-eof-power-mode;
		qcom,mdss-dsi-bllp-power-mode;
		qcom,mdss-dsi-tx-eot-append;
		qcom,mdss-dsi-lane-0-state;
		qcom,mdss-dsi-lane-1-state;
		qcom,mdss-dsi-lane-2-state;
		qcom,mdss-dsi-lane-3-state;
		qcom,mdss-dsi-dma-trigger = "trigger_sw";
		qcom,mdss-dsi-mdp-trigger = "none";
		qcom,mdss-dsi-lp11-init;
		qcom,mdss-dsi-bl-pmic-control-type = "bl_ctrl_dcs";
		qcom,mdss-dsi-bl-min-level = <1>;
		qcom,dispparam-enabled;
		qcom,mdss-dsi-bl-max-level = <2047>;
		qcom,mdss-brightness-max-level = <2047>;
		qcom,mdss-dsi-bl-inverted-dbv;
		qcom,mdss-dsi-reset-sequence = <1 10>, <0 10>, <1 10>;
		qcom,esd-err-irq-gpio-m = <&tlmm 36 0x2002>;
		qcom,mdss-dsi-pan-enable-dynamic-fps;
		qcom,mdss-dsi-pan-fps-update = "dfps_immediate_porch_mode_vfp";
		qcom,dsi-supported-dfps-list = <90 60 50 48 30>;
		qcom,mdss-pan-physical-width-dimension = <1474>;
		qcom,mdss-pan-physical-height-dimension = <2358>;
		qcom,platform-reset-gpio-always-on;
		qcom,mdss-dsi-display-timings {
			timing@0 {
				qcom,mdss-dsi-panel-width = <1200>;
				qcom,mdss-dsi-panel-height = <1920>;
				qcom,mdss-dsi-h-pulse-width = <4>;
				qcom,mdss-dsi-h-back-porch = <92>;
				qcom,mdss-dsi-h-front-porch = <90>;

				qcom,mdss-dsi-h-sync-skew = <0>;
				qcom,mdss-dsi-v-pulse-width = <4>;
				qcom,mdss-dsi-v-back-porch = <16>;
				qcom,mdss-dsi-v-front-porch = <54>;
				qcom,mdss-dsi-panel-framerate = <90>;
				qcom,mdss-dsi-on-command = [
					39 01 00 00 00 00 02 FF 23
					39 01 00 00 00 00 02 FB 01
					39 01 00 00 00 00 02 00 60
					39 01 00 00 00 00 02 07 20
					39 01 00 00 00 00 02 08 01
					39 01 00 00 00 00 02 09 80

					//CABC Setting
					39 01 00 00 00 00 02 FF 23
					39 01 00 00 00 00 02 FB 01
					//Force Data Gain
					39 01 00 00 00 00 02 03 00
					//Data Gain
					39 01 00 00 00 00 02 0A 1D
					39 01 00 00 00 00 02 0B 1D
					39 01 00 00 00 00 02 0C A8
					39 01 00 00 00 00 02 0D 05
					//APL_WT=0
					39 01 00 00 00 00 02 10 00
					//Resolution Related : 1200x1920
					39 01 00 00 00 00 02 11 01
					39 01 00 00 00 00 02 12 68
					39 01 00 00 00 00 02 15 EA
					39 01 00 00 00 00 02 16 15
					//UI Mode
					39 01 00 00 00 00 02 30 FF
					39 01 00 00 00 00 02 31 FE
					39 01 00 00 00 00 02 32 FD
					39 01 00 00 00 00 02 33 FC
					39 01 00 00 00 00 02 34 FB
					39 01 00 00 00 00 02 35 FA
					39 01 00 00 00 00 02 36 F8
					39 01 00 00 00 00 02 37 F6
					39 01 00 00 00 00 02 38 F3
					39 01 00 00 00 00 02 39 F2
					39 01 00 00 00 00 02 3A F0
					39 01 00 00 00 00 02 3B EE
					39 01 00 00 00 00 02 3D EC
					39 01 00 00 00 00 02 3F EA
					39 01 00 00 00 00 02 40 E8
					39 01 00 00 00 00 02 41 E6
					//Still Mode
					39 01 00 00 00 00 02 45 FF
					39 01 00 00 00 00 02 46 FC
					39 01 00 00 00 00 02 47 F8
					39 01 00 00 00 00 02 48 F3
					39 01 00 00 00 00 02 49 ED
					39 01 00 00 00 00 02 4A E7
					39 01 00 00 00 00 02 4B E1
					39 01 00 00 00 00 02 4C DA
					39 01 00 00 00 00 02 4D D2
					39 01 00 00 00 00 02 4E C9
					39 01 00 00 00 00 02 4F BF
					39 01 00 00 00 00 02 50 B5
					39 01 00 00 00 00 02 51 AB
					39 01 00 00 00 00 02 52 A1
					39 01 00 00 00 00 02 53 93
					39 01 00 00 00 00 02 54 83
					//MOV mode
					39 01 00 00 00 00 02 58 FF
					39 01 00 00 00 00 02 59 FD
					39 01 00 00 00 00 02 5A FA
					39 01 00 00 00 00 02 5B F8
					39 01 00 00 00 00 02 5C F5
					39 01 00 00 00 00 02 5D F0
					39 01 00 00 00 00 02 5E EA
					39 01 00 00 00 00 02 5F E2
					39 01 00 00 00 00 02 60 DC
					39 01 00 00 00 00 02 61 D7
					39 01 00 00 00 00 02 62 D2
					39 01 00 00 00 00 02 63 CD
					39 01 00 00 00 00 02 64 C8
					39 01 00 00 00 00 02 65 C2
					39 01 00 00 00 00 02 66 B0
					39 01 00 00 00 00 02 67 AE
					//GAMMA SEL
					39 01 00 00 00 00 02 19 00
					39 01 00 00 00 00 02 1A 04
					39 01 00 00 00 00 02 1B 08
					39 01 00 00 00 00 02 1C 0C
					39 01 00 00 00 00 02 1D 10
					39 01 00 00 00 00 02 1E 14
					39 01 00 00 00 00 02 1F 18
					39 01 00 00 00 00 02 20 1C
					39 01 00 00 00 00 02 21 20
					39 01 00 00 00 00 02 22 24
					39 01 00 00 00 00 02 23 28
					39 01 00 00 00 00 02 24 2C
					39 01 00 00 00 00 02 25 30
					39 01 00 00 00 00 02 26 34
					39 01 00 00 00 00 02 27 38
					39 01 00 00 00 00 02 28 3C

					39 01 00 00 00 00 02 29 10
					39 01 00 00 00 00 02 2A 20
					39 01 00 00 00 00 02 2B 20

					/*set esd*/
					39 01 00 00 00 00 02 FF 27
					39 01 00 00 00 00 02 FB 01
					39 01 00 00 00 00 02 13 00
					39 01 00 00 00 00 02 14 22
					39 01 00 00 00 00 02 D0 31
					39 01 00 00 00 00 02 D1 28
					39 01 00 00 00 00 02 D2 38
					39 01 00 00 00 00 02 D4 08
					39 01 00 00 00 00 02 DE 43
					39 01 00 00 00 00 02 DF 02

					39 01 00 00 00 00 02 FF 20
					39 01 00 00 00 00 02 FB 01
					39 01 00 00 00 00 02 01 22
					39 01 00 00 00 00 02 02 22

					39 01 00 00 00 00 02 FF 10
					39 01 00 00 00 00 02 FB 01
					39 01 00 00 00 00 07 3B 03 14 36 0A 0A 00
					39 01 00 00 00 00 02 90 13
					39 01 00 00 00 00 11 91 89 A8 00 08 D2 00 00 00 00 F0 00 10 0E DC 05 B9
					39 01 00 00 00 00 03 92 10 F0
					39 01 00 00 00 00 03 68 02 01
					39 01 00 00 00 00 03 51 07 32
					39 01 00 00 00 00 02 53 2C
					//39 01 00 00 00 00 02 35 00
					15 01 00 00 64 00 02 11 00
					15 01 00 00 14 00 02 29 00
				];

				qcom,mdss-dsi-off-command = [
					39 01 00 00 00 00 02 FF 23
					39 01 00 00 00 00 02 FB 01
					39 01 00 00 00 00 02 06 00
					39 01 00 00 00 00 02 FF 10
					39 01 00 00 00 00 02 FB 01
					15 01 00 00 32 00 02 28 00
					15 01 00 00 96 00 02 10 00
				];
/*
				qcom,mdss-dsi-dispparam-fps-90hz-command = [
					39 00 00 40 00 00 02 FF 10
					39 00 00 00 00 00 02 B3 00];
				qcom,mdss-dsi-dispparam-fps-60hz-command = [
					39 00 00 40 00 00 02 FF 10
					39 00 00 00 00 00 02 B3 40];
				qcom,mdss-dsi-dispparam-fps-50hz-command = [
					39 00 00 40 00 00 02 FF 10
					39 00 00 00 00 00 02 B3 40];
				qcom,mdss-dsi-dispparam-fps-48hz-command = [
					39 00 00 40 00 00 02 FF 10
					39 00 00 00 00 00 02 B3 40];
				qcom,mdss-dsi-dispparam-fps-30hz-command = [
					39 00 00 40 00 00 02 FF 10
					39 00 00 00 00 00 02 B3 40];
*/
				qcom,mdss-dsi-dispparam-cabc-ui-on-command = [
					39 00 00 40 00 00 02 FF 23
					39 00 00 40 00 00 02 FB 01
					39 00 00 40 00 00 02 04 06
					39 00 00 40 00 00 02 05 36
					39 00 00 40 00 00 02 06 04
					39 00 00 40 00 00 02 FF 10
					39 00 00 40 00 00 02 FB 01
					39 01 00 00 00 00 02 55 01
				];
				qcom,mdss-dsi-dispparam-cabc-still-on-command = [
					39 00 00 40 00 00 02 FF 23
					39 00 00 40 00 00 02 FB 01
					39 00 00 40 00 00 02 04 06
					39 00 00 40 00 00 02 05 36
					39 00 00 40 00 00 02 06 04
					39 00 00 40 00 00 02 FF 10
					39 00 00 40 00 00 02 FB 01
					39 01 00 00 00 00 02 55 02
				];
				qcom,mdss-dsi-dispparam-cabc-movice-on-command = [
					39 00 00 40 00 00 02 FF 23
					39 00 00 40 00 00 02 FB 01
					39 00 00 40 00 00 02 04 06
					39 00 00 40 00 00 02 05 36
					39 00 00 40 00 00 02 06 04
					39 00 00 40 00 00 02 FF 10
					39 00 00 40 00 00 02 FB 01
					39 01 00 00 00 00 02 55 03
				];
				qcom,mdss-dsi-dispparam-cabc-off-command = [
					39 00 00 40 00 00 02 FF 23
					39 00 00 40 00 00 02 FB 01
					39 00 00 40 00 00 02 04 06
					39 00 00 40 00 00 02 05 36
					39 00 00 40 00 00 02 06 04
					39 00 00 40 00 00 02 FF 10
					39 00 00 40 00 00 02 FB 01
					39 01 00 00 00 00 02 55 00
				];
				mi,mdss-dsi-hbm-on-command = [
					39 01 00 00 00 00 03 51 07 FF
				];
				mi,mdss-dsi-hbm-off-command = [
					39 01 00 00 00 00 03 68 05 01
					39 01 00 00 00 00 03 51 07 32
				];

				qcom,mdss-dsi-on-command-state = "dsi_lp_mode";
				qcom,mdss-dsi-off-command-state = "dsi_lp_mode";
				//qcom,mdss-dsi-dispparam-fps-90hz-command-state = "dsi_hs_mode";
				//qcom,mdss-dsi-dispparam-fps-60hz-command-state = "dsi_hs_mode";
				//qcom,mdss-dsi-dispparam-fps-50hz-command-state = "dsi_hs_mode";
				//qcom,mdss-dsi-dispparam-fps-48hz-command-state = "dsi_hs_mode";
				//qcom,mdss-dsi-dispparam-fps-30hz-command-state = "dsi_hs_mode";
				qcom,mdss-dsi-dispparam-cabc-ui-on-command-status = "dsi_lp_mode";
				qcom,mdss-dsi-dispparam-cabc-still-on-command-status = "dsi_lp_mode";
				qcom,mdss-dsi-dispparam-cabc-movice-on-command-status = "dsi_lp_mode";
				qcom,mdss-dsi-dispparam-cabc-off-command-status = "dsi_lp_mode";
				mi,mdss-dsi-hbm-on-command-state = "dsi_lp_mode";
				mi,mdss-dsi-hbm-off-command-state = "dsi_lp_mode";

				qcom,compression-mode = "dsc";
				qcom,mdss-dsc-version = <0x11>;
				qcom,mdss-dsc-scr-version = <0x0>;
				qcom,mdss-dsc-slice-height = <8>;
				qcom,mdss-dsc-slice-width = <1200>;
				qcom,mdss-dsc-slice-per-pkt = <2>;
				qcom,mdss-dsc-bit-per-component = <8>;
				qcom,mdss-dsc-bit-per-pixel = <8>;
				qcom,mdss-dsc-block-prediction-enable;
			};
		};
	};
};

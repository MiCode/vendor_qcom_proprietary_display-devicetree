/dts-v1/;
/plugin/;

#include "amethyst-sde-display.dtsi"

/ {
	model = "Qualcomm Technologies, Inc. Amethyst based on volcano";
	compatible = "qcom,volcano-mtp", "qcom,volcano", "qcom,volcanop-mtp", "qcom,volcanop", "qcom,mtp";
	qcom,msm-id = <636 0x10000>, <640 0x10000>, <641 0x10000>;
	qcom,board-id = <8 0>;
	xiaomi,miboard-id = <0xC 0>;
};

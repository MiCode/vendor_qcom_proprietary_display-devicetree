/dts-v1/;
/plugin/;

#include <dt-bindings/interrupt-controller/arm-gic.h>
#include "bengal-sde-display-idp.dtsi"

/ {
	model = "Qualcomm Technologies, Inc. BENGAL IDP";
	compatible = "qcom,bengal-idp", "qcom,bengal", "qcom,idp";
	qcom,msm-id = <417 0x10000>, <444 0x10000>, <469 0x10000>, <469 0x0>, <470 0x10000>, <470 0x0>;
	qcom,board-id = <34 0>, <34 1>;
	qcom,pmic-id = <0x2D 0x25 0x0 0x0>;
};

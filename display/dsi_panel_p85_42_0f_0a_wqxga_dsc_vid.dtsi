&mdss_mdp {
	dsi_panel_p85_42_0f_0a_wqxga_dsc_vid: qcom,mdss_dsi_panel_p85_42_0f_0a_wqxga_dsc_vid {
		qcom,mdss-dsi-panel-name =
			"p85 42 0f 0a wqxga dsc vid panel";
		qcom,mdss-dsi-panel-type = "dsi_video_mode";

		qcom,dsi-ctrl-num = <0>;
		qcom,dsi-phy-num = <0>;

		qcom,mdss-dsi-virtual-channel-id = <0>;
		qcom,mdss-dsi-stream = <0>;
		qcom,mdss-dsi-h-left-border = <0>;
		qcom,mdss-dsi-h-right-border = <0>;
		qcom,mdss-dsi-v-top-border = <0>;
		qcom,mdss-dsi-v-bottom-border = <0>;
		qcom,mdss-dsi-bpp = <24>;
		qcom,mdss-dsi-color-order = "rgb_swap_rgb";
		qcom,mdss-dsi-underflow-color = <0xff>;
		qcom,mdss-dsi-border-color = <0>;
		qcom,mdss-dsi-h-sync-pulse = <0>;
		qcom,mdss-dsi-traffic-mode = "non_burst_sync_event";
		qcom,mdss-dsi-lane-map = "lane_map_0123";
		qcom,mdss-dsi-bllp-eof-power-mode;
		qcom,mdss-dsi-bllp-power-mode;
		qcom,mdss-dsi-tx-eot-append;
		qcom,mdss-dsi-lane-0-state;
		qcom,mdss-dsi-lane-1-state;
		qcom,mdss-dsi-lane-2-state;
		qcom,mdss-dsi-lane-3-state;
		qcom,mdss-dsi-dma-trigger = "trigger_sw";
		qcom,mdss-dsi-mdp-trigger = "none";
		qcom,mdss-dsi-lp11-init;
		qcom,platform-reset-gpio-always-on;
		qcom,ulps-enabled;
		qcom,suspend-ulps-enabled;
		qcom,mdss-dsi-bl-pmic-control-type = "bl_ctrl_external";
		qcom,mdss-dsi-reset-sequence = <0 5>, <1 5>, <0 5>, <1 15>;
		qcom,mdss-pan-physical-width-dimension = <1299>;
		qcom,mdss-pan-physical-height-dimension = <2078>;
		qcom,mdss-dsi-pan-enable-dynamic-fps;
		qcom,mdss-dsi-pan-fps-update = "dfps_immediate_porch_mode_vfp";
		qcom,dsi-supported-dfps-list = <120 90 60>;
		qcom,mdss-dsi-display-timings {
			timing@0 {
				qcom,mdss-dsi-video-mode;
				qcom,mdss-dsi-panel-width = <1280>;
				qcom,mdss-dsi-panel-height = <2048>;
				qcom,mdss-dsi-h-pulse-width = <24>;
				qcom,mdss-dsi-h-back-porch = <64>;
				qcom,mdss-dsi-h-front-porch = <64>;

				qcom,mdss-dsi-h-sync-skew = <0>;
				qcom,mdss-dsi-v-pulse-width = <4>;
				qcom,mdss-dsi-v-back-porch = <32>;
				qcom,mdss-dsi-v-front-porch = <430>;
				qcom,mdss-dsi-panel-framerate = <120>;
				qcom,mdss-dsi-panel-clockrate = <1049000000>;
				qcom,mdss-dsi-on-command = [
					39 01 00 00 00 00 04 F0 99 51 0C
                                	39 01 00 00 00 00 21 E0 3A F0 3C 86 3C B8 3C F9 3D 3C 3D 72 3D B2 3E 35 3E A8 3F 30 3F 70 3F 90 3F 90 3F 90 3F 90 3F 90
					39 01 00 00 00 00 21 E1 2A 60 2D 3F 2E 3F 2F FF 31 47 32 8F 33 D6 35 1E 37 66 38 EF 3A 78 3C 01 3D 8A 3E B4 3F 28 3F 88
					39 01 00 00 00 00 21 E2 2D 80 30 5A 31 22 32 42 33 36 34 CF 36 66 37 CE 39 36 3A AA 3B 80 3C 71 3D 9A 3E B4 3F 28 3F 88
					39 01 00 00 00 00 21 E3 F1 F5 F7 F8 F9 FA FB FD FE FE FF FF FF FF FF FF EC EC EC EC EC EC ED EF F3 F5 F7 F9 FC FE FF FF
					39 01 00 00 00 00 20 E4 EF F0 F1 F2 F3 F4 F4 F5 F6 F8 FA FB FD FE FF FF 0F 1F 2F 3F 4F 5F 6F 7F 90 A0 B0 C0 D0 E0 F0
					39 01 00 00 00 00 20 E5 8C 00 30 00 00 00 00 00 00 0E C9 9F 00 B8 00 04 00 00 04 84 0C 28 2E 1A C7 00 00 00 00 00 00
					39 01 00 00 00 00 04 C2 00 07 05
					39 01 00 00 00 00 03 35 00 00
					39 01 00 00 00 00 03 51 00 00
					39 01 00 00 00 00 02 53 24
                                        39 01 00 00 00 00 02 55 00
					05 01 00 00 78 00 01 11
					05 01 00 00 0A 00 01 29
					39 01 00 00 00 00 08 BD 6D 23 42 51 29 02 1F
					39 01 00 00 00 00 04 F0 99 51 00
					39 01 00 00 00 00 02 AC 05
				];
				qcom,mdss-dsi-off-command = [
					39 01 00 00 00 00 04 F0 99 51 0C
					39 01 00 00 00 00 02 AC 0A
					15 01 00 00 0A 00 02 28 00
					15 01 00 00 78 00 02 10 00
					39 01 00 00 00 00 02 CC 01
				];
				qcom,mdss-dsi-gesture-commands = [
					39 01 00 00 00 00 04 F0 99 51 0C
					39 01 00 00 00 00 02 AC 0A
					15 01 00 00 0A 00 02 28 00
					15 01 00 00 78 00 02 10 00
				];
				mi,mdss-dsi-backlight-pwm-command = [
					39 01 00 00 05 00 03 51 0f ff
					39 01 00 00 00 00 02 53 2c
				];
				mi,mdss-dsi-cabc-ui-on-command = [
					39 01 00 00 00 00 02 55 01
				];
				mi,mdss-dsi-cabc-still-on-command =[
					39 01 00 00 00 00 02 55 02
				];
				mi,mdss-dsi-cabc-movie-on-command = [
					39 01 00 00 00 00 02 55 03
				];
				mi,mdss-dsi-cabc-off-command =[
					39 01 00 00 00 00 02 55 00
				];
				qcom,mdss-dsi-on-command-state = "dsi_lp_mode";
				qcom,mdss-dsi-off-command-state = "dsi_lp_mode";
				qcom,mdss-dsi-gesture-commands-state = "dsi_lp_mode";
				mi,mdss-dsi-backlight-pwm-command-state = "dsi_lp_mode";
				mi,mdss-dsi-cabc-ui-on-command-state = "dsi_lp_mode";
				mi,mdss-dsi-cabc-still-on-command-state = "dsi_lp_mode";
				mi,mdss-dsi-cabc-movie-on-command-state = "dsi_lp_mode";
				mi,mdss-dsi-cabc-off-command-state = "dsi_lp_mode";
				qcom,compression-mode = "dsc";
				qcom,mdss-dsc-version = <0x11>;
				qcom,mdss-dsc-scr-version = <0x0>;
				qcom,mdss-dsc-slice-height = <8>;
				qcom,mdss-dsc-slice-width = <640>;
				qcom,mdss-dsc-slice-per-pkt = <2>;
				qcom,mdss-dsc-bit-per-component = <8>;
				qcom,mdss-dsc-bit-per-pixel = <8>;
				qcom,mdss-dsc-block-prediction-enable;
			};
		};
	};
};
